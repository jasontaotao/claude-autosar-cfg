AUTOSAR XML (schema 00050)
package /AUTOSAR
  module definition Dcm  # Diagnostic communication manager (subset, v1.27.0 real-OEM fixture; Vector-derived convention). Container shortNames match canonical AUTOSAR (DcmDsp* prefix).
    container DcmDspClearDTC [0..1]  # Canonical AUTOSAR container for UDS service 0x14 (Clear Diagnostic Information). Referenced by xlsx sheet 'DcmClearDTC'.
    container DcmDspReadDTCInformation [0..1]  # Canonical AUTOSAR container for UDS service 0x19 (ReadDTCInformation). Referenced by xlsx sheet 'DcmReadDTC'.
    container DcmDspDid [0..1]  # Canonical AUTOSAR parent container for UDS services 0x22 (ReadDataById) and 0x2E (WriteDataById). The mapper differentiates via per-row definitionRef emitted in PatchSteps. Referenced by xlsx sheets 'DcmReadDataById' and 'DcmWriteDataById'.
      reference didRef [0..1]: ecuc-reference-value=DcmDspDid  # Reference to the ODX-extracted DCM-DSP-DID data instance this service reads from. v1.27.5 PATCH — value path corrected to use the AUTOSAR root-package prefix (/AUTOSAR/...) which the real-OEM BSWMD's AR-PACKAGE/SHORT-NAME=AUTOSAR declares. v1.27.2 PATCH release notes said both demo-ecu + real-OEM got the REFERENCES enrichment but the value path retained the demo-ecu prefix; v1.27.5 PATCH's end-to-end test caught the drift.
    container DcmDspRoutine [0..1]  # Canonical AUTOSAR container for UDS service 0x31 (RoutineControl). Referenced by xlsx sheet 'DcmRoutineControl'.
      reference routineRef [0..1]: ecuc-reference-value=DcmDspRoutine  # Reference to the ODX-extracted DCM-DSP-ROUTINE data instance this service controls. v1.27.5 PATCH — closes the partial-fixture-enrichment gap left by v1.27.2 PATCH (which added didRef to DcmDspDid but accidentally skipped routineRef on DcmDspRoutine in the real-OEM BSWMD; v1.27.2 release notes Out-of-Scope section listed the routineRef enrichment but the in-file edit was incomplete).
