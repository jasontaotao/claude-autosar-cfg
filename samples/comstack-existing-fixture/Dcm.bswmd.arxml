AUTOSAR XML (schema 00050)
package /AUTOSAR
  module definition Dcm  # Diagnostic communication manager (subset, v1.27.0 real-OEM fixture; Vector-derived convention). Container shortNames match canonical AUTOSAR (DcmDsp* prefix).
    container DcmDspClearDTC [0..1]  # Canonical AUTOSAR container for UDS service 0x14 (Clear Diagnostic Information). Referenced by xlsx sheet 'DcmClearDTC'.
    container DcmDspReadDTCInformation [0..1]  # Canonical AUTOSAR container for UDS service 0x19 (ReadDTCInformation). Referenced by xlsx sheet 'DcmReadDTC'.
    container DcmDspDid [0..1]  # Canonical AUTOSAR parent container for UDS services 0x22 (ReadDataById) and 0x2E (WriteDataById). The mapper differentiates via per-row definitionRef emitted in PatchSteps. Referenced by xlsx sheets 'DcmReadDataById' and 'DcmWriteDataById'.
      reference didRef [0..1]: ecuc-reference-value=DcmDspDid  # Reference to the ODX-extracted DCM-DSP-DID data instance this service reads from.
    container DcmDspRoutine [0..1]  # Canonical AUTOSAR container for UDS service 0x31 (RoutineControl). Referenced by xlsx sheet 'DcmRoutineControl'.
