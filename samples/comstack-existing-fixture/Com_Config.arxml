AUTOSAR XML (schema 00050)
package /Com
  module config Com
    ComConfig
