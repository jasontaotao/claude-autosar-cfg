AUTOSAR XML (schema 00050)
package /AUTOSAR
  module definition CanIf  # CAN interface (subset for v1.25.0 T4 real-OEM fixture)
    container CanIfConfig
      container CanIfTxPdu [0..65535]
        integer CanIfTxPduId: 0..65535, default-value=0
        integer CanIfTxPduCanId: 0..4294967295, default-value=0
        integer CanIfTxPduDlc: 0..8, default-value=8
      container CanIfRxPdu [0..65535]
        integer CanIfRxPduId: 0..65535, default-value=0
        integer CanIfRxPduCanId: 0..4294967295, default-value=0
        integer CanIfRxPduDlc: 0..8, default-value=8
