AUTOSAR XML (schema 00050)
package /AUTOSAR
  module definition PduR  # PDU router (subset for v1.25.0 T4 real-OEM fixture)
    container PduRRoutingPaths
      container PduRRoutingPath [0..65535]
        integer PduRRoutingPathPriority: 0..65535, default-value=0
        integer PduRSrcPduHandleId: 0..65535, default-value=0
        integer PduRDestPduHandleId: 0..65535, default-value=0
