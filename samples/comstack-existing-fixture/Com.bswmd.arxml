AUTOSAR XML (schema 00050)
package /AUTOSAR
  module definition Com  # Communication module (subset for v1.25.0 T4 real-OEM fixture)
    container ComConfig
      container ComIPdu [0..65535]
        integer ComHandleId: 0..65535, default-value=0
        integer ComPduId: 0..65535, default-value=0
        enumeration ComIPduDirection: {SEND, RECEIVE}, default-value=SEND
      container ComSignal [0..65535]
        integer ComHandleId: 0..65535, default-value=0
        integer ComBitPosition: 0..63, default-value=0
        integer ComBitSize: 0..65535, default-value=16
