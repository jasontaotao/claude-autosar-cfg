AUTOSAR XML (schema 00050)
package /AUTOSAR
  module definition ComM  # Communication manager (subset for Demo ECU)
    container ComMConfigSet
      container ComMChannel [0..32]
