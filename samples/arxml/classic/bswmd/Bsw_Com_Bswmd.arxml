AUTOSAR XML (schema 00050)
package /AUTOSAR
  module definition Com  # Communication module (subset for Demo ECU)
    container ComConfig
      container ComIPdu [0..256]
        integer ComPduId: 0..65535
