AUTOSAR XML (schema 00050)
package /AUTOSAR
  module definition CanIf  # CAN interface (subset for Demo ECU)
    container CanIfInitCfg
