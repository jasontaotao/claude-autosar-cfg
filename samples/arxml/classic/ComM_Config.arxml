AUTOSAR XML (schema 00050)
package /ComM
  module config ComM
    ComMConfigSet
