AUTOSAR XML (schema 00050)
package /EcuC
  module config EcuC
    EcuCGeneral: ConfigConsistencyRequired=true
