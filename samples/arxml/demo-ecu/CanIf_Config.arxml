AUTOSAR XML (schema 00050)
package /CanIf
  module config CanIf
    CanIfInitCfg
