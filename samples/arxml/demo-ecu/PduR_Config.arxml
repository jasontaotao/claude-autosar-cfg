AUTOSAR XML (schema 00050)
package /PduR
  module config PduR
    PduRRoutingPaths
