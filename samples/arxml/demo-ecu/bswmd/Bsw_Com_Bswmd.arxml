AUTOSAR XML (schema 00050)
package /AUTOSAR
  module definition Com  # Communication module (subset for Demo ECU; enriched v1.25.x PATCH for XlsxBatchWizard template download)
    container ComConfig
      container ComIPdu [0..256]
        integer ComPduId: 0..65535, default-value=0
        integer ComBitPosition [0..1]: 0..63, default-value=0
        enumeration ComIPduDirection: {SEND, RECEIVE}, default-value=SEND
      container ComSignal [0..65536]
        integer ComBitPosition [0..1]: 0..63, default-value=0
        enumeration ComSignalDirection: {SEND, RECEIVE}, default-value=SEND
        enumeration ComErrorNotification [0..1]: {NONE, APPLICATION}, default-value=NONE
