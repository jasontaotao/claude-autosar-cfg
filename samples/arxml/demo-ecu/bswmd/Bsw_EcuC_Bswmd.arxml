AUTOSAR XML (schema 00050)
package /AUTOSAR
  module definition EcuC  # ECU configuration (subset for Demo ECU)
    container EcuCGeneral
      boolean ConfigConsistencyRequired
