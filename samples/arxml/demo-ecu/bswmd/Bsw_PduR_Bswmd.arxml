AUTOSAR XML (schema 00050)
package /AUTOSAR
  module definition PduR  # PDU router (subset for Demo ECU)
    container PduRRoutingPaths [0..1]
      container PduRRoutingPath [0..256]
