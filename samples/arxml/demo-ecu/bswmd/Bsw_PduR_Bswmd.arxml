AUTOSAR XML (schema 00050)
package /AUTOSAR
  module definition PduR  # PDU Router (subset for Demo ECU; enriched v1.25.x PATCH)
    container PduRRoutingTables [0..1]
      container PduRRoutingPath [0..65536]
        integer PduRRoutingPathPriority [0..1]: 0..65535, default-value=0
        integer PduRSrcPduHandleId: 0..65535, default-value=0
        integer PduRDestPduHandleId: 0..65535, default-value=0
