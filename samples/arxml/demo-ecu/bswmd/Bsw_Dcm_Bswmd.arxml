AUTOSAR XML (schema 4-4)
package /Dcm
  module definition Dcm  # Demo-ecu Dcm module definition (v1.27.0 ship fixture). Container shortNames match canonical AUTOSAR (DcmDsp* prefix per the claude-autosarcfg-canonical-autosar-pdur-paths-not-tables lesson). The xlsx sheet names (DcmClearDTC / DcmReadDTC / DcmReadDataById / DcmWriteDataById / DcmRoutineControl) are abstracted; the SHEET_TO_CONTAINER_SHORT_NAME seam in src/core/bridge/xlsxDcmServicesToEcucBatch.ts maps them to these canonical container shortNames.
    container DcmDspClearDTC  # Canonical AUTOSAR container for UDS service 0x14 (Clear Diagnostic Information). Referenced by xlsx sheet 'DcmClearDTC'.
    container DcmDspReadDTCInformation  # Canonical AUTOSAR container for UDS service 0x19 (ReadDTCInformation). Referenced by xlsx sheet 'DcmReadDTC'.
    container DcmDspDid  # Canonical AUTOSAR parent container for UDS services 0x22 (ReadDataById) and 0x2E (WriteDataById). The mapper differentiates via per-row definitionRef emitted in PatchSteps. Referenced by xlsx sheets 'DcmReadDataById' and 'DcmWriteDataById'.
      reference didRef [0..1]: ecuc-reference-value=DcmDspDid  # Reference to the ODX-extracted DCM-DSP-DID data instance this service reads from.
    container DcmDspRoutine  # Canonical AUTOSAR container for UDS service 0x31 (RoutineControl). Referenced by xlsx sheet 'DcmRoutineControl'.
      reference routineRef [0..1]: ecuc-reference-value=DcmDspRoutine  # Reference to the ODX-extracted DCM-DSP-ROUTINE data instance this service controls.
