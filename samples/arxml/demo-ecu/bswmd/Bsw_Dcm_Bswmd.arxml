AUTOSAR XML (schema 4-4)
package /Dcm
  module definition Dcm: desciption=Demo-ecu Dcm module definition (v1.27.0 ship fixture).
    container DcmClearDTC: desciption=UDS service 0x14 — Clear Diagnostic Information.
    container DcmReadDTC: desciption=UDS service 0x19 — Read DTC Information.
    container DcmReadDataById: desciption=UDS service 0x22 — Read Data By Identifier (references DcmDspDid).
    container DcmWriteDataById: desciption=UDS service 0x2E — Write Data By Identifier (references DcmDspDid).
    container DcmRoutineControl: desciption=UDS service 0x31 — Routine Control (references DcmDspRoutine).
