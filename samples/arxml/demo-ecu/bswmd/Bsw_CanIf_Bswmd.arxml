AUTOSAR XML (schema 00050)
package /AUTOSAR
  module definition CanIf  # CAN interface (subset for Demo ECU; enriched v1.25.x PATCH)
    container CanIfInitCfg
    container CanIfConfig [0..1]
      container CanIfTxPdu [0..65536]
        integer CanIfTxPduId [0..1]: 0..65535, default-value=0
        integer CanIfTxPduCanId [0..1]: 0..536870911, default-value=0
        integer CanIfTxPduDlc [0..1]: 0..8, default-value=8
      container CanIfRxPdu [0..65536]
        integer CanIfRxPduId [0..1]: 0..65535, default-value=0
        integer CanIfRxPduCanId [0..1]: 0..536870911, default-value=0
        integer CanIfRxPduDlc [0..1]: 0..8, default-value=8
