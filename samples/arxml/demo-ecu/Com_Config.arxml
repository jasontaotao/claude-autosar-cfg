AUTOSAR XML (schema 00050)
package /Com
  module config Com
    ComConfig
      3 x ComIPdu:
        ComIPdu_1: ComPduId=42
        ComIPdu_2: ComPduId=42
        EngState: ComPduId=272
