AUTOSAR XML (schema 00050)
package /Com
  module config Com
    ComConfig
      ComIPdu_1 (ComIPdu): ComPduId=42
      ComIPdu_2 (ComIPdu): ComPduId=42
