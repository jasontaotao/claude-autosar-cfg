VERSION "powertrain-v1"

NS_ :

BS_:

BU_: ECM TCM

VAL_TABLE_ GearTable 0 "Park" 1 "Reverse" 2 "Neutral" 3 "Drive" ;

BO_ 272 EngState: 8 ECM
SG_ EngineRPM : 0|16@1+ (0.25,0) [0|16383.75] "rpm" TCM
SG_ ThrottlePos : 16|8@1+ (0.392157,0) [0|100] "%" TCM

BO_ 544 TransState: 8 TCM
SG_ Gear : 0|4@1+ (1,0) [0|7] "" ECM
SG_ OilTemp : 8|8@1- (1,-40) [-40|215] "degC" ECM

VAL_ 544 Gear 0 "Park" 1 "Reverse" 2 "Neutral" 3 "Drive" ;
