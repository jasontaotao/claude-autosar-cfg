AUTOSAR XML (schema 00046)
package /JWQ_CDD_PACK/JWQ_Packet
  module definition JWQ3399: post-build-variant-support=true, refined-module-def=JWQ3399, variants post-build/pre-compile  # Configuration of the JWQ3399 module.
    container JWQ3399ConfigSet
      container JWQ3399SpiConfig: multiplicity set at pre-compile
        container JWQ3399SpiSequenceRef [0..*]: multiplicity set at pre-compile
          reference SpiRefParam [0..1]: multiplicity set at pre-compile, destination=JWQ3399ConfigSet  # 预留，未与spi模块关联，因此该ref为空不可用
          string UserDefRef [0..1]: format-value=General, set at pre-compile  # 用户定义spi的sequence名
        container JWQ3399SpiChannelRef [0..*]: multiplicity set at pre-compile
          reference SpiRefParam [0..1]: multiplicity set at pre-compile, destination=JWQ3399ConfigSet  # 预留，未与spi模块关联，因此该ref为空不可用
          string UserDefRef [0..1]: format-value=General, set at pre-compile  # 用户定义spi的channel名
        choice container JWQ3399SpiCsConfig
          container SpiCsViaPher [0..1]
          container SpiCsViaGPIO [0..1]
            string DioChannelRef [0..1]: format-value=General, set at pre-compile
        choice container JWQ3399SpiHWUnitRef
          container SpiHWUnitRef [0..1]
          container SpiHWUnitUserDef [0..1]
            string SpiHWUnitUserDef [0..1]: format-value=General, set at pre-compile
      container JWQ3399AFECellValidSet [0..*]: multiplicity set at pre-compile
        integer SampleValidBitSet: 0..262143, default-value=0, set at pre-compile  # 一个bit代表一个电压采集通道有效，顺序从低到高
      container JWQ3399AFETempValidSet [0..*]: multiplicity set at pre-compile
        integer SampleValidBitSet: 0..2047, default-value=0, set at pre-compile  # 一个bit代表一个温度采集通道有效，顺序从低到高
        integer BalanceTempValidBitSet: 0..2047, default-value=0, set at pre-compile  # 一个bit代表一个均衡温度采集通道有效，顺序从低到高
      container JWQ3399InitConfig: multiplicity set at pre-compile
        integer InitFastSampleCount: 0..10, default-value=1, set at pre-compile
        container InitDiagTask_Channel [0..*]: multiplicity set at pre-compile
          function name DiagTaskPreCallback: default-value=NULL_PTR
          function name DiagTaskFunction: default-value=NULL_PTR
          function name DiagTaskPostCallback: default-value=NULL_PTR
      container JWQ3399LoopConfig: multiplicity set at pre-compile
        container JWQ3399Task_TriggerChannel [0..*]: multiplicity set at pre-compile
          function name PreCallback: default-value=NULL_PTR
          function name Function: default-value=NULL_PTR
          function name PostCallback: default-value=NULL_PTR
        container JWQ3399Task_CycleChannel [0..*]: multiplicity set at pre-compile
          boolean IfInitRegister: default-value=false, set at pre-compile
          function name PreCallback: default-value=NULL_PTR
          function name Function: default-value=NULL_PTR
          function name PostCallback: default-value=NULL_PTR
          float StartOffsetTime: 0..1000, default-value=0, set at pre-compile
          float CycleTime: 0.001..1000, default-value=1, set at pre-compile
    container JWQ3399General
      boolean JWQ3399DevErrorDetect: default-value=false, set at pre-compile
      integer JWQ3399ChipNum: 1..32, default-value=1, set at pre-compile  # AFE芯片数量
      enumeration JWQ3399CommArch: set at pre-compile  # JWQ3399通讯架构选择
        CommArchWithBridge  # JWQ3399通讯架构选择
        CommArchWithOutBridge  # JWQ3399通讯架构选择
      float JWQ3399MainFunctionPeriod: 0.0000001..1000.0, default-value=0.01, set at pre-compile
      container JWQ3399GPIOConfig: multiplicity set at pre-compile
        boolean JWQ3399_GPIO_I2C_ENABLE: default-value=false, set at pre-compile
        boolean JWQ3399_GPIO_SPI_SLA_ENABLE: default-value=false, set at pre-compile
        boolean JWQ3399_GPIO_FAULT_ENABLE: default-value=false, set at pre-compile
        boolean JWQ3399_GPIO_SPI_MLA_ENABLE: default-value=false, set at pre-compile
        boolean JWQ3399_GPIO_CS2_ENABLE: default-value=false, set at pre-compile
        container JWQ3399GPIOxConfigure: multiplicity set at pre-compile
          enumeration GPIO{1..11}: {DISABLED, ADC_INPUT_OTUT1_PRT, ADC_INPUT_OTUT2_PRT, DIGITAL_INPUT, DIGITAL_OUTPUT, ADC_INPUT_ABSOLUTE}, set at pre-compile
      container JWQ3399OVUV_OTUTConfig: multiplicity set at pre-compile
        boolean OVUV_Enable: default-value=false, set at pre-compile
        boolean OTUT_Enable: default-value=false, set at pre-compile
        container OVUV_Thresholds [0..1]: multiplicity set at pre-compile
          integer OV_ThresholdConfig: 0..165, default-value=0, set at pre-compile  # overvoltage threshold for the overvoltage protection. 0x00 = 2700 mV. 0x01 = 2725 mV. … 0x0B = 2975 mV. 0x0C = 3000 mV. 0x0D-0x3F = Reserved (2700 mV). 0x40 = 3600 mV. 0x41 = 3625 mV. … 0x4F = 3975 mV. 0x50 = 4000 mV. 0x51-0x7F = Reserved (2700 mV). 0x80 = 4175 mV. 0x81 = 4200 mV. … 0xA4 = 5075 mV. 0xA5 = 5100 mV. 0xA6-0xFF = Reserved (2700 mV)
          integer UV_ThresholdConfig: 0..50, default-value=0, set at pre-compile  # undervoltage threshold for the undervoltage protection. 0x00 = 1200 mV. 0x01 = 1250 mV. … 0x31 = 3650 mV. 0x32 = 3700 mV.
        container OTUT_Thresholds [0..1]: multiplicity set at pre-compile
          integer UT1_ThresholdConfig: 0..7, default-value=0, set at pre-compile  # UT threshold for the under-temperature protection. The PTC or NTC ranges are selected by the DEV_CONF2[PTC_EN] register. [PTC_EN] = 0: 0b000-0b111 = Range from 72% to 86% of VTS in step of 2% (NTC). [PTC_EN] = 1: 0b000-0b011 = Range from 43% to 46% of VTS in step of 1% (PTC). 0b100-0b111 = Reserved (46%) (PTC).
          integer OT1_ThresholdConfig: 0..15, default-value=0, set at pre-compile  # the OT threshold for the overtemperature protection . The PTC or NTC ranges are selected by the DEV_CONF2[PTC_EN] register. [PTC_EN] = 0: 0b0_0000-0b1_0100 = Range from 10% to 30% of VTS in step of 1% (NTC). 0b1_0101-0b1_1111 = Reserved (30%) (NTC). [PTC_EN] = 1: 0b0_0000-0b0_0111 = Range from 53% to 60% of VTS in step of 1% (PTC). 0b0_1000-0b1_1111 = Reserved (60%) (PTC).
          integer UT2_ThresholdConfig: 0..7, default-value=0, set at pre-compile  # the UT threshold for the under-temperature protection. The PTC or NTC ranges are selected by the DEV_CONF2[PTC_EN] register. [PTC_EN] = 0: 0b000-0b111 = Range from 72% to 86% of VTS in step of 2% (NTC). [PTC_EN] = 1: 0b000-0b011 = Range from 43% to 46% of VTS in step of 1% (PTC). 0b100-0b111 = Reserved (46%) (PTC).
          integer OT2_ThresholdConfig: 0..15, default-value=0, set at pre-compile  # the OT threshold for the overtemperature protection . The PTC or NTC ranges are selected by the DEV_CONF2[PTC_EN] register. [PTC_EN] = 0: 0b0_0000-0b1_0100 = Range from 10% to 30% of VTS in step of 1% (NTC). 0b1_0101-0b1_1111 = Reserved (30%) (NTC). [PTC_EN] = 1: 0b0_0000-0b0_0111 = Range from 53% to 60% of VTS in step of 1% (PTC). 0b0_1000-0b1_1111 = Reserved (60%) (PTC).
        container OVUV_HB_Threshold [0..1]: multiplicity set at pre-compile
          integer DeltaOVThreshold: 0..15, default-value=0, set at pre-compile  # the delta overvoltage threshold for the delta overvoltage protection for heartbeat mode. 0x0= 12mV 0x1= 24mV 0x2= 36mV … 0xE= 180mV 0xF= 192mV
        container OTUT_HB_Threshold [0..1]: multiplicity set at pre-compile
          integer DeltaOTThreshold: 0..15, default-value=0, set at pre-compile  # the OT threshold for the overtemperature protection (load the data from the corresponding registers in OTP, and can write the register to cover the data) 0x0=1% of the VTS 0x1=2% of the VTS … 0xE=15% of the VTS 0xF=16% of the VTS DOV is applied to both OTUT1 and OTUT2 protection and also no whether the external thermistor is NTC or PTC.
      container JWQ3399CommunicateConfig: multiplicity set at pre-compile
        enumeration ResponseForWriteCommand: {ResponseForWriteConmmand, NoResponseForWriteConmmand}, default-value=ResponseForWriteConmmand, set at pre-compile
        enumeration CommunicationDirection: {ISOH, ISOL}, default-value=ISOH, set at pre-compile
        enumeration BaudRate: {2Mbps, 1Mbps}, default-value=2Mbps, set at pre-compile
        enumeration ModeBalancePowerConsumption: {Disable, Enable}, default-value=Disable, set at pre-compile
      container JWQ3399ADCConfig: multiplicity set at pre-compile
        enumeration CADCAverageMode: {DisableAverageModeCADC, EnableAverageModeCADC}, default-value=DisableAverageModeCADC, set at pre-compile
        enumeration ResultFreezeMode: {ResultNotFreozen, ResultFrozen}, default-value=ResultNotFreozen, set at pre-compile
        enumeration IIR_COEFF: {Frequency_100Hz, Frequency_42Hz, Frequency_21Hz, Frequency_10Hz, Frequency_4p3Hz, Frequency_2p3Hz, Frequency_1p1Hz, Frequency_0p6Hz}, default-value=Frequency_100Hz, set at pre-compile
        enumeration IIR_filterdModeADC: {DisableIIRfilterdMode, EnableIIRfilterdMode}, default-value=DisableIIRfilterdMode, set at pre-compile
        enumeration CellADCRunMode: {ONE_SHOT_SINGLE_MEASURE, CONTINUOUS_MEASURE}, default-value=ONE_SHOT_SINGLE_MEASURE, set at pre-compile
        enumeration AuxADCRunMode: {ONE_SHOT_SINGLE_MEASURE, CONTINUOUS_MEASURE}, default-value=ONE_SHOT_SINGLE_MEASURE, set at pre-compile
      container JWQ3399DiagConfig: multiplicity set at pre-compile
      container JWQ3399DevConfig: multiplicity set at pre-compile
        enumeration PTCorNTC: {NTCsUsed, PTCsUsed}, default-value=NTCsUsed, set at pre-compile
        enumeration NumberOfCells: {6S(C15_C4NotUsed), 7S(C15_C5NotUsed), 8S(C15_C6NotUsed), 9S(C15_C7NotUsed), 10S(C15_C8NotUsed), 11S(C15_C9NotUsed), 12S(C15_C10NotUsed), 13S(C15_C11NotUsed), 14S(C15_C12NotUsed), 15S(C15_C13NotUsed), 16S(C15_C14NotUsed), 17S(C15NotUsed), 18S}, default-value=18S, set at pre-compile
        enumeration Cell10BusBarConnected: {ConnectedWithOutBusBar, ConnectedWithBusBar}, default-value=ConnectedWithOutBusBar, set at pre-compile
        enumeration DevicePackage: {LQFP_64, LQFP_80}, default-value=LQFP_64, set at pre-compile
      container JWQ3399StateConfig: multiplicity set at pre-compile
        integer ComTimeOutSet: 0..7, default-value=0, set at pre-compile  # Sets the communication timeout. When this timer expires, the device sets the FAULT_SYS1[COMM_TIMEOUT] bit. When this timer expires, the device takes the action configured by the [COMM_TIMEOUT_CTRL] bit. The timer resets if device receives command or response in NORMAL mode. 000 = Disables communication timeout (default at reset); 001 = 2ms; 010 = 5ms; 011 = 10ms; 100 = 20ms; 101 = 30ms; 110 = 60ms; 111 = 100ms
        integer InactiveTimeoutSet: 0..7, default-value=0, set at pre-compile  # A timeout in NORMAL mode. This timer starts counting when device has no activities(cell balancing and cell measurement) in NORMAL. When the timer expires, the device enters SLEEP/SHIP mode depends SLEEP_SHIP_CTRL. The timer resets if device is active in NORMAL mode. 000 = No timeout. Device remains in NORMAL mode 001 = 2 s; 010 = 5 s; 011 = 10 s 100 = 30s; 101 = 1 min (default at reset); 110 = 10 min; 111 = 30 min
        integer InactiveSleepTimeOut: 0..7, default-value=0, set at pre-compile  # A timeout in SLEEP mode. This timer starts counting when device enters SLEEP mode and no activities (cell balancing). When the timer expires, the device enters SHIP mode if SLEEP_SHIP_CTRL=0. The timer resets when device wakes up to NORMAL mode or the device has activity in SLEEP mode. 000 = No timeout. Device remains in SLEEP mode (default at reset) 011 = 1 min 100 = 10 min 101 = 30 min 110 = 1 hour 111 = 2 hour
        integer CycleTimeSleepToHB: 0..15, default-value=0, set at pre-compile  # The cycle time of the device goes to HEARTBEAT mode from SLEEP. (This time is for the top stack device using, other devices use two times of t the timeout of tcyc_HB_TO) 0000 = disable HEARTBEAT mode (default) 0001 = disable HEARTBEAT mode (reserved) 0010 = disable HEARTBEAT mode (reserved) 0011 = 50 milliseconds 0100 = 100 milliseconds 0101 = 200 milliseconds 0110 = 300 milliseconds 0111 = 500 milliseconds 1000 =1 second. 1001 = 2 seconds. 1010 = 4 seconds. 1011 = 8 seconds. 1100 = 12 seconds. 1101 = 16 seconds. 1110 = 32 seconds. 1111 = 64 seconds
        enumeration SLEEP_SHIP_CTRL: default-value=GetsIntoSHIP, set at pre-compile  # This bit is to set the lowest power-consumption and regular mode for the device. 0: The lowest power-consumption and regular mode for the device is SHIP mode (default) 1: The lowest power-consumption and regular mode for the device is SLEEP mode (In this mode, the device goes to SHIP only when there are some faults)
          GetsIntoSHIP  # This bit is to set the lowest power-consumption and regular mode for the device. 0: The lowest power-consumption and regular mode for the device is SHIP mode (default) 1: The lowest power-consumption and regular mode for the device is SLEEP mode (In this mode, the device goes to SHIP only when there are some faults)
          GetsIntoSLEEP  # This bit is to set the lowest power-consumption and regular mode for the device. 0: The lowest power-consumption and regular mode for the device is SHIP mode (default) 1: The lowest power-consumption and regular mode for the device is SLEEP mode (In this mode, the device goes to SHIP only when there are some faults)
        enumeration COMM_TIMEOUT_CTRL: default-value=SHIP, set at pre-compile  # 1: The device gets into SLEEP when communication timeout occurs. 0: The device gets into SHIP when communication timeout occurs. (default)
          SHIP  # 1: The device gets into SLEEP when communication timeout occurs. 0: The device gets into SHIP when communication timeout occurs. (default)
          SLEEP  # 1: The device gets into SLEEP when communication timeout occurs. 0: The device gets into SHIP when communication timeout occurs. (default)
      container JWQ3399BalanceConfig: multiplicity set at pre-compile
        boolean OTCBEnable: default-value=false, set at pre-compile  # Enable the OTCB detection of external thermistors during cell balancing. The selection is sampled whenever [BAL_GO] = 1 is set by the host. 0 = disable OTCB detection (default) 1 = enable OTCB detection Note: The OTCB protection is only enabled when the GPIOx are set as ADC input & OTUT1 or ADC input & OTUT2.
        integer CellBalanceStopThreshold: 0..121, default-value=0, set at pre-compile  # If a cell’s voltage < this threshold, the cell balancing on that cell stops. This threshold setting applies to all the cells. 0x00 = Disable voltage comparison for cell balancing done threshold 0x01 = 2000 mV. 0x02 = 2025 mV. … 0x78 = 4975 mV. 0x79 = 5000 mV.
        container OTCBThresholds [0..1]: multiplicity set at pre-compile
          integer OTCBThreshold{1..3}: 0..15, default-value=0, set at pre-compile  # Set the OTCB threshold{1..3} of the external thermistors for the OTUT comparator when BAL_CTRL1[OTCB_EN] = 1. The MCU shall configure the corresponding GPIO(s) to “ADC & OTUT input”. The PTC or NTC ranges are selected by the DEV_CONF2[PTC_EN] register. [PTC_EN] = 0: 0b0000-0b0101 = Range from 5% to 10% in steps of 1% (NTC). 0b0110-0b1100 = Range from 12% to 24% in steps of 2% (NTC). 0b1101-0b1111 = Reserved (24%) (NTC). [PTC_EN] = 1: 0b0000-0b0111 = Range from 56% to 63% in steps of 1% (PTC). 0b1000-0b1111 = Reserved (63%) (PTC).
          integer OTCBHysteresis: 0..7, default-value=0, set at pre-compile  # Set the OTCB hysteresis of the external thermistors for the OTUT comparator when BAL_CTRL2[OTCB_EN] = 1 0b000=5mV 0b001=10mV 0b010=15mV 0b011=20mV 0b100=25mV 0b101=30mV 0b110=35mV 0b111=40mV
      container JWQ3399FaultMaskConfig: multiplicity set at pre-compile
        enumeration MaskFaultOVUV: {NoMaskAssertFaultBit, MaskRegardlessFaultBit}, default-value=NoMaskAssertFaultBit, set at pre-compile
        enumeration MaskFaultOTUT: {NoMaskAssertFaultBit, MaskRegardlessFaultBit}, default-value=NoMaskAssertFaultBit, set at pre-compile
        enumeration MaskFaultCELL: {NoMaskAssertFaultBit, MaskRegardlessFaultBit}, default-value=NoMaskAssertFaultBit, set at pre-compile
        enumeration MaskFaultGPIO: {NoMaskAssertFaultBit, MaskRegardlessFaultBit}, default-value=NoMaskAssertFaultBit, set at pre-compile
        enumeration MaskFaultCOM: {NoMaskAssertFaultBit, MaskRegardlessFaultBit}, default-value=NoMaskAssertFaultBit, set at pre-compile
        enumeration MaskFaultPWR: {NoMaskAssertFaultBit, MaskRegardlessFaultBit}, default-value=NoMaskAssertFaultBit, set at pre-compile
        enumeration MaskFaultSYS: {NoMaskAssertFaultBit, MaskRegardlessFaultBit}, default-value=NoMaskAssertFaultBit, set at pre-compile
        enumeration MaskFaultDIGMEM: {NoMaskAssertFaultBit, MaskRegardlessFaultBit}, default-value=NoMaskAssertFaultBit, set at pre-compile
        container Masks_OVUV_OTUT: multiplicity set at pre-compile
        container Container_{9..11}: multiplicity set at pre-compile
