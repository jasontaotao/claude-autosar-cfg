AUTOSAR XML (schema 00046)
package /AUTOSAR_R22/EcucDefs
  module definition Adc: post-build-variant-support=true, refined-module-def=Adc, variants post-build/pre-compile  # Configuration of the Adc module.
    container AdcConfigSet  # This container contains the configuration parameters and sub containers of the AUTOSAR Adc module.
      container AdcHwUnit [1..*]: multiplicity set at pre-compile  # This container contains the Driver configuration (parameters) depending on grouping of channels
        integer AdcPrescale [0..1]: 0..65535, set at pre-compile  # Optional ADC module specific clock prescale factor, if supported by hardware.
        enumeration AdcClockSource [0..1]: set at pre-compile  # The ADC module specific clock input for the conversion unit can statically be configured to select different clock sources if provided by hardware. Enumeration literals are defined vendor specific.
        enumeration AdcHwUnitId: set at pre-compile  # Description: Numeric ID of the HW Unit. This symbolic name allows accessing Hw Unit data. Enumeration literals are defined vendor specific.
        container AdcChannel [1..*]: multiplicity set at pre-compile  # This container contains the channel configuration (parameters) depending on the hardware capability.
          boolean AdcChannelLimitCheck [0..1]: set at pre-compile  # Enables or disables limit checking for an ADC channel.
          integer AdcChannelConvTime [0..1]: 0..18446744073709551615, set at pre-compile  # Configuration of conversion time, i.e. the time during which the analogue value is converted into digital representation, (in clock cycles) for each channel, if supported by hardware.
          integer AdcChannelHighLimit [0..1]: 0..18446744073709551615, set at pre-compile  # High limit - used for limit checking.
          integer AdcChannelId: 0..1024, set at pre-compile  # This parameter defines the assignment of the channel to the physical ADC hardware channel.
          integer AdcChannelLowLimit [0..1]: 0..18446744073709551615, set at pre-compile  # Low limit - used for limit checking.
          integer AdcChannelResolution [0..1]: 1..63, set at pre-compile  # Channel resolution in bits.
          integer AdcChannelSampTime [0..1]: 0..18446744073709551615, set at pre-compile  # Configuration of sampling time, i.e. the time during which the value is sampled, (in clock cycles) for each channel, if supported by hardware.
          enumeration AdcChannelRangeSelect [0..1]: set at pre-compile  # In case of active limit checking: defines which conversion values are taken into account related to the boarders defined with AdcChannelLowLimit and AdcChannelHighLimit.
            ADC_RANGE_ALWAYS  # In case of active limit checking: defines which conversion values are taken into account related to the boarders defined with AdcChannelLowLimit and AdcChannelHighLimit.
            ADC_RANGE_BETWEEN  # In case of active limit checking: defines which conversion values are taken into account related to the boarders defined with AdcChannelLowLimit and AdcChannelHighLimit.
            ADC_RANGE_NOT_BETWEEN  # In case of active limit checking: defines which conversion values are taken into account related to the boarders defined with AdcChannelLowLimit and AdcChannelHighLimit.
            ADC_RANGE_NOT_OVER_HIGH  # In case of active limit checking: defines which conversion values are taken into account related to the boarders defined with AdcChannelLowLimit and AdcChannelHighLimit.
            ADC_RANGE_NOT_UNDER_LOW  # In case of active limit checking: defines which conversion values are taken into account related to the boarders defined with AdcChannelLowLimit and AdcChannelHighLimit.
            ADC_RANGE_OVER_HIGH  # In case of active limit checking: defines which conversion values are taken into account related to the boarders defined with AdcChannelLowLimit and AdcChannelHighLimit.
            ADC_RANGE_UNDER_LOW  # In case of active limit checking: defines which conversion values are taken into account related to the boarders defined with AdcChannelLowLimit and AdcChannelHighLimit.
          enumeration AdcChannelRefVoltsrcHigh [0..1]: set at pre-compile  # Upper reference voltage source for each channel.
          enumeration AdcChannelRefVoltsrcLow [0..1]: set at pre-compile  # Lower reference voltage source for each channel.
        container AdcGroup [1..*]: multiplicity set at pre-compile  # This container contains the Group configuration (parameters).
          reference AdcGroupDefinition [1..*]: multiplicity set at pre-compile, destination=AdcChannel  # Assignment of AdcChannels to a AdcGroups.
          reference AdcGroupEcucPartitionRef [0..*]: multiplicity set at pre-compile, destination=EcucPartition  # Maps an ADC channel group to zero or multiple ECUC partitions to limit the access to this channel group. The ECUC partitions referenced are a subset of the ECUC partitions where the ADC driver is mapped to.
          integer AdcGroupId: 0..1023, set at pre-compile, symbolic-name-value=true  # Numeric ID of the group. This parameter is the symbolic name to be used on the API. This symbolic name allows accessing Channel Group data. This value will be assigned to the symbolic name derived of the AdcGroup container shortName.
          integer AdcGroupPriority [0..1]: 0..255, set at pre-compile  # Priority level of the AdcGroup.
          integer AdcHwTrigTimer [0..1]: 0..18446744073709551615, set at pre-compile  # Reload value of the ADC module embedded timer (only if supported by ADC hardware).
          integer AdcStreamingNumSamples: 1..255, default-value=1, set at pre-compile  # Number of ADC values to be acquired per channel in streaming access mode.
          enumeration AdcGroupAccessMode: set at pre-compile  # Type of access mode to group conversion results.
            ADC_ACCESS_MODE_SINGLE  # Type of access mode to group conversion results.
            ADC_ACCESS_MODE_STREAMING  # Type of access mode to group conversion results.
          enumeration AdcGroupConversionMode: set at pre-compile  # Type of conversion mode supported by the driver.
            ADC_CONV_MODE_CONTINUOUS  # Type of conversion mode supported by the driver.
            ADC_CONV_MODE_ONESHOT  # Type of conversion mode supported by the driver.
          enumeration AdcGroupReplacement [0..1]: set at pre-compile  # Replacement mechanism, which is used on ADC group level, if a group conversion is interrupted by a group which has a higher priority.
            ADC_GROUP_REPL_ABORT_RESTART  # Replacement mechanism, which is used on ADC group level, if a group conversion is interrupted by a group which has a higher priority.
            ADC_GROUP_REPL_SUSPEND_RESUME  # Replacement mechanism, which is used on ADC group level, if a group conversion is interrupted by a group which has a higher priority.
          enumeration AdcGroupTriggSrc: set at pre-compile  # Type of source event that starts a group conversion.
            ADC_TRIGG_SRC_HW  # Type of source event that starts a group conversion.
            ADC_TRIGG_SRC_SW  # Type of source event that starts a group conversion.
          enumeration AdcHwTrigSignal [0..1]: set at pre-compile  # Configures on which edge of the hardware trigger signal the driver should react, i.e. start the conversion (only if supported by the ADC hardware).
            ADC_HW_TRIG_BOTH_EDGES  # Configures on which edge of the hardware trigger signal the driver should react, i.e. start the conversion (only if supported by the ADC hardware).
            ADC_HW_TRIG_FALLING_EDGE  # Configures on which edge of the hardware trigger signal the driver should react, i.e. start the conversion (only if supported by the ADC hardware).
            ADC_HW_TRIG_RISING_EDGE  # Configures on which edge of the hardware trigger signal the driver should react, i.e. start the conversion (only if supported by the ADC hardware).
          enumeration AdcStreamingBufferMode: set at pre-compile  # Configure streaming buffer as "linear buffer" (i.e. the ADC Driver stops the conversion as soon as the stream buffer is full) or as "ring buffer" (wraps around if the end of the stream buffer is reached).
            ADC_STREAM_BUFFER_CIRCULAR  # Configure streaming buffer as "linear buffer" (i.e. the ADC Driver stops the conversion as soon as the stream buffer is full) or as "ring buffer" (wraps around if the end of the stream buffer is reached).
            ADC_STREAM_BUFFER_LINEAR  # Configure streaming buffer as "linear buffer" (i.e. the ADC Driver stops the conversion as soon as the stream buffer is full) or as "ring buffer" (wraps around if the end of the stream buffer is reached).
          function name AdcNotification [0..1]  # Callback function for each group
    container AdcGeneral  # General configuration (parameters) of the ADC Driver software module.
      reference AdcEcucPartitionRef [0..*]: multiplicity set at pre-compile, destination=EcucPartition  # Maps the ADC driver to zero or multiple ECUC partitions to make the driver API available in the according partition.
      reference AdcKernelEcucPartitionRef [0..1]: multiplicity set at pre-compile, destination=EcucPartition  # Maps the ADC kernel to zero or one ECUC partitions to assign the driver kernel to a certain core. The ECUC partition referenced is a subset of the ECUC partitions where the ADC driver is mapped to.
      boolean AdcDeInitApi: set at pre-compile  # Adds / removes the service Adc_DeInit() from the code.
      boolean AdcDevErrorDetect: default-value=false, set at pre-compile  # Switches the development error detection and notification on or off.
      boolean AdcEnableLimitCheck: set at pre-compile  # Enables or disables limit checking feature in the ADC driver.
      boolean AdcEnableQueuing: set at pre-compile  # Determines, if the queuing mechanism is active in case of priority mechanism disabled.
      boolean AdcEnableStartStopGroupApi: set at pre-compile  # Adds / removes the services Adc_StartGroupConversion() and Adc_StopGroupConversion() from the code.
      boolean AdcGrpNotifCapability: set at pre-compile  # Determines, if the group notification mechanism (the functions to enable and disable the notifications) is available at runtime.
      boolean AdcHwTriggerApi: set at pre-compile  # Adds / removes the services Adc_EnableHardwareTrigger() and Adc_DisableHardwareTrigger() from the code.
      boolean AdcLowPowerStatesSupport [0..1]: default-value=false, set at pre-compile  # Adds / removes all power state management related APIs (ADC_SetPowerState, ADC_GetCurrentPowerState, ADC_GetTargetPowerState, ADC_PreparePowerState, ADC_Main_PowerTransitionManager), indicating if the HW offers low power state management.
      boolean AdcPowerStateAsynchTransitionMode [0..1]: default-value=false, set at pre-compile  # Enables / disables support of the ADCDriver to the asynchronous power state transition.
      boolean AdcReadGroupApi: set at pre-compile  # Adds / removes the service Adc_ReadGroup() and from the code.
      boolean AdcVersionInfoApi: default-value=false, set at pre-compile  # Adds / removes the service Adc_GetVersionInfo() from the code.
      enumeration AdcPriorityImplementation: set at pre-compile  # Determines whether a priority mechanism is available for prioritization of the conversion requests and if available, the type of prioritization mechanism. The selection applies for groups with trigger source software and trigger source hardware.
        ADC_PRIORITY_HW  # Determines whether a priority mechanism is available for prioritization of the conversion requests and if available, the type of prioritization mechanism. The selection applies for groups with trigger source software and trigger source hardware.
        ADC_PRIORITY_HW_SW  # Determines whether a priority mechanism is available for prioritization of the conversion requests and if available, the type of prioritization mechanism. The selection applies for groups with trigger source software and trigger source hardware.
        ADC_PRIORITY_NONE  # Determines whether a priority mechanism is available for prioritization of the conversion requests and if available, the type of prioritization mechanism. The selection applies for groups with trigger source software and trigger source hardware.
      enumeration AdcResultAlignment: set at pre-compile  # Alignment of ADC raw results in ADC result buffer (left/right alignment).
        ADC_ALIGN_LEFT  # Alignment of ADC raw results in ADC result buffer (left/right alignment).
        ADC_ALIGN_RIGHT  # Alignment of ADC raw results in ADC result buffer (left/right alignment).
      container AdcPowerStateConfig [0..*]: multiplicity set at pre-compile  # Each instance of this parameter defines a power state and the callback to be called when this power state is reached.
        integer AdcPowerState: 0..18446744073709551615, set at pre-compile, symbolic-name-value=true  # Each instance of this parameter describes a different power state supported by the ADC HW. It should be defined by the HW supplier and used by the ADCDriver to reference specific HW configurations which set the ADC HW module in the referenced power state.
        function name AdcPowerStateReadyCbkRef  # Each instance of this parameter contains a reference to a power mode callback defined in a CDD or IoHwAbs component.
    container AdcPublishedInformation  # Additional published parameters not covered by "Common" Published Information. Note that these parameters have "PUBLISHED-INFORMATION" configuration class setting, since they are published information.
      boolean AdcChannelValueSigned: set at pre-compile  # Information whether the result value of the ADC driver has sign information (true) or not (false). If the result shall be interpreted as signed value it shall apply to C-language rules.
      boolean AdcGroupFirstChannelFixed: set at pre-compile  # Information whether the first channel of an ADC Channel group can be configured (false) or is fixed (true) to a value determined by the ADC HW Unit.
      integer AdcMaxChannelResolution: 1..63, set at pre-compile  # Maximum Channel resolution in bits (does not specify accuracy).
