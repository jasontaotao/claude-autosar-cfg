AUTOSAR XML (schema 4-0-3)
package /AUTOSAR_Can/BswModuleDescriptions
  bsw module description Can: module-id=80, provided-entrys=[Can_Init, Can_MainFunction_Mode]
    bsw internal behavior InternalBehavior_0
      12 x exclusive area:
        CAN_EXCLUSIVE_AREA_{00..09}
        CAN_EXCLUSIVE_AREA_11
        CAN_EXCLUSIVE_AREA_13
      bsw called entity Can_Init: can-enter-exclusive-area=[CAN_EXCLUSIVE_AREA_00, CAN_EXCLUSIVE_AREA_01, CAN_EXCLUSIVE_AREA_02, CAN_EXCLUSIVE_AREA_03, CAN_EXCLUSIVE_AREA_04, CAN_EXCLUSIVE_AREA_05, CAN_EXCLUSIVE_AREA_06, CAN_EXCLUSIVE_AREA_07, CAN_EXCLUSIVE_AREA_08, CAN_EXCLUSIVE_AREA_09, CAN_EXCLUSIVE_AREA_11, CAN_EXCLUSIVE_AREA_13], implemented-entry=Can_Init
      bsw schedulable entity Can_MainFunction_Mode: implemented-entry=Can_MainFunction_Mode, scheduler-name-prefix=Prefix_Can
      bsw timing event TimingEvent_MainFunction_Mode: starts-on-event=Can_MainFunction_Mode, period=0.005
      bsw scheduler name prefix Prefix_Can: symbol=Can
package /AUTOSAR_Can/BswModuleEntrys
  bsw module entry Can_Init: service-id=0, is-reentrant=false, is-synchronous=true, call-type=REGULAR, execution-context=UNSPECIFIED, sw-service-impl-policy=STANDARD
  bsw module entry Can_MainFunction_Mode: service-id=12, is-reentrant=false, is-synchronous=true, call-type=SCHEDULED, execution-context=TASK, sw-service-impl-policy=STANDARD
package /Can_TS_T40D2M10I2R0/Implementations
  bsw implementation BswImplementation_0: programming-language=C, sw-version=1.0.2, vendor-id=43, ar-release-version=4.2.2, behavior=InternalBehavior_0, vendor-specific-module-def=Can
    code-descriptors:
      code Files: artifact-descriptors=[{short-label=make::Can_defs.mak, category=SWMAKE}, {short-label=make::Can_rules.mak, category=SWMAKE}]
    resource consumption ResourceConsumption
      5 x memory section:
        CAN_CODE: sw-addrmethod=CODE, symbol=CODE
        CAN_CONFIG_DATA_UNSPECIFIED: alignment=UNSPECIFIED, sw-addrmethod=CONFIG_DATA, symbol=CONFIG_DATA_UNSPECIFIED
        CAN_CONST_UNSPECIFIED: alignment=UNSPECIFIED, sw-addrmethod=CONST, symbol=CONST_UNSPECIFIED
        CAN_VAR_INIT_UNSPECIFIED: alignment=UNSPECIFIED, sw-addrmethod=VAR_INIT, symbol=VAR_INIT_UNSPECIFIED
        CAN_VAR_NO_INIT_UNSPECIFIED: alignment=UNSPECIFIED, sw-addrmethod=VAR_NO_INIT, symbol=VAR_NO_INIT_UNSPECIFIED
