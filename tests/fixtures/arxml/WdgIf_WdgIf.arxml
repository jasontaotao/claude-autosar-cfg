AUTOSAR XML (schema 4-2-2)
package /EcucDefs
  ecuc definition collection AUTOSARParameterDefinition: module=WdgIf
  module config WdgIf: implementation-config-variant=STD_CONFIG_VARIANTS_PRECOMPILE, module_version_def=1.2.1, module_autosar_version=Ar422
    WdgIfGeneral: WdgIfDevErrorDetect=true, WdgIfVersionInfoApi=false, VersionCheck=true
    Device0 (WdgIfDevice):
      WdgIfDeviceIndex = 0
      WdgSetModeName = Wdg_SetMode
      WdgSetTriggerConditionName = Wdg_SetTriggerCondition
      DeviceHeaderFile = 
      WdgIfDriverRef = /EAS/Wdg/WdgGeneral/
