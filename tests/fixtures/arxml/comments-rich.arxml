AUTOSAR XML (schema 4-2-2)
package /Cluster
  module config TestModule
    TestContainer (): TestParam=42
