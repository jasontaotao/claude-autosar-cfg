AUTOSAR XML (schema 4-2-2)
package /EcucDefs
  ecuc definition collection AUTOSARParameterDefinition: module=PduR
  module config PduR: implementation-config-variant=STD_CONFIG_VARIANTS_PRECOMPILE, module_version_def=1.1.23, module_autosar_version=Ar422
    PduRGeneral:
      VersionCheck = true
      PduRDevErrorDetect = false
      PduRVersionInfoApi = false
      PduRZeroCostOperation = false
      CanIfModuleSupport = true
      CanTpModuleSupport = true
      ComModuleSupport = true
      DcmModuleSupport = true
      LinIfModuleSupport = false
      LinTpModuleSupport = false
      DoIPIfModuleSupport = false
      DoIPTpModuleSupport = false
      SoAdIfModuleSupport = false
      SoAdTpModuleSupport = false
      CddModuleSupport = false
      CddIfModuleSupport = false
      J1939DcmModuleSupport = false
      J1939TpModuleSupport = true
      CanNmModuleSupport = false
      J1939RmModuleSupport = false
      FrIfModuleSupport = false
      FrTpModuleSupport = false
      SecOcModuleSupport = false
      UdpNmModuleSupport = false
      IpduMModuleSupport = false
      IpduMIfModuleSupport = false
      SecOcIfModuleSupport = false
    CanConfigSet (PduRRoutingTables): PduRConfigurationId=0, UserDefine=false
      PduRRoutingTable: PduRMaxRoutingPathCnt=255, PduRMaxRoutingPathGroupCnt=255, PduRMaxRoutingTableCnt=255
        112 x PduRRoutingPath:
          CanConfigSet_Rx_CAN_Network_MCU_MotorSts: UserDefine=false
            Src_CanConfigSet_Rx_CAN_Network_MCU_MotorSts (PduRSrcPdu): PduRSourcePduHandleId=0, PduRSrcModule=CANIF, PduRSrcPduUpTxConf=true, UserDefine=false, PduRSrcPduRef=CanConfigSet_Rx_CAN_Network_MCU_MotorSts
            Dest_CanConfigSet_Rx_CAN_Network_MCU_MotorSts (PduRDestPdu):
              PduRDestPduDataProvision = PDUR_DIRECT
              PduRDestPduHandleId = 0
              PduRTpThreshold = 7
              PduRTransmissionConfirmation = true
              PduRDestModule = COM
              UserDefine = false
              PduRDestPduRef = CanConfigSet_Rx_CAN_Network_MCU_MotorSts
              PduRDestTxBufferRef = /EAS/PduR/PduRRoutingTables/PduRTxBufferTable/PduRTxBuffer/
          CanConfigSet_Rx_CAN_Network_OBC_GeneralSts: UserDefine=false
            Src_CanConfigSet_Rx_CAN_Network_OBC_GeneralSts (PduRSrcPdu): PduRSourcePduHandleId=1, PduRSrcModule=CANIF, PduRSrcPduUpTxConf=true, UserDefine=false, PduRSrcPduRef=CanConfigSet_Rx_CAN_Network_OBC_GeneralSts
            Dest_CanConfigSet_Rx_CAN_Network_OBC_GeneralSts (PduRDestPdu):
              PduRDestPduDataProvision = PDUR_DIRECT
              PduRDestPduHandleId = 0
              PduRTpThreshold = 7
              PduRTransmissionConfirmation = true
              PduRDestModule = COM
              UserDefine = false
              PduRDestPduRef = CanConfigSet_Rx_CAN_Network_OBC_GeneralSts
              PduRDestTxBufferRef = /EAS/PduR/PduRRoutingTables/PduRTxBufferTable/PduRTxBuffer/
          CanConfigSet_Rx_CAN_Network_OBC_ChgParameter: UserDefine=false
            Src_CanConfigSet_Rx_CAN_Network_OBC_ChgParameter (PduRSrcPdu): PduRSourcePduHandleId=2, PduRSrcModule=CANIF, PduRSrcPduUpTxConf=true, UserDefine=false, PduRSrcPduRef=CanConfigSet_Rx_CAN_Network_OBC_ChgParameter
            Dest_CanConfigSet_Rx_CAN_Network_OBC_ChgParameter (PduRDestPdu):
              PduRDestPduDataProvision = PDUR_DIRECT
              PduRDestPduHandleId = 0
              PduRTpThreshold = 7
              PduRTransmissionConfirmation = true
              PduRDestModule = COM
              UserDefine = false
              PduRDestPduRef = CanConfigSet_Rx_CAN_Network_OBC_ChgParameter
              PduRDestTxBufferRef = /EAS/PduR/PduRRoutingTables/PduRTxBufferTable/PduRTxBuffer/
          CanConfigSet_Rx_CAN_Network_DCDC_StatusInfo: UserDefine=false
            Src_CanConfigSet_Rx_CAN_Network_DCDC_StatusInfo (PduRSrcPdu): PduRSourcePduHandleId=3, PduRSrcModule=CANIF, PduRSrcPduUpTxConf=true, UserDefine=false, PduRSrcPduRef=CanConfigSet_Rx_CAN_Network_DCDC_StatusInfo
            Dest_CanConfigSet_Rx_CAN_Network_DCDC_StatusInfo (PduRDestPdu):
              PduRDestPduDataProvision = PDUR_DIRECT
              PduRDestPduHandleId = 0
              PduRTpThreshold = 7
              PduRTransmissionConfirmation = true
              PduRDestModule = COM
              UserDefine = false
              PduRDestPduRef = CanConfigSet_Rx_CAN_Network_DCDC_StatusInfo
              PduRDestTxBufferRef = /EAS/PduR/PduRRoutingTables/PduRTxBufferTable/PduRTxBuffer/
          CanConfigSet_Rx_CAN_Network_TBOX_TD: UserDefine=false
            Src_CanConfigSet_Rx_CAN_Network_TBOX_TD (PduRSrcPdu): PduRSourcePduHandleId=4, PduRSrcModule=CANIF, PduRSrcPduUpTxConf=true, UserDefine=false, PduRSrcPduRef=CanConfigSet_Rx_CAN_Network_TBOX_TD
            Dest_CanConfigSet_Rx_CAN_Network_TBOX_TD (PduRDestPdu):
              PduRDestPduDataProvision = PDUR_DIRECT
              PduRDestPduHandleId = 0
              PduRTpThreshold = 7
              PduRTransmissionConfirmation = true
              PduRDestModule = COM
              UserDefine = false
              PduRDestPduRef = CanConfigSet_Rx_CAN_Network_TBOX_TD
              PduRDestTxBufferRef = /EAS/PduR/PduRRoutingTables/PduRTxBufferTable/PduRTxBuffer/
          CanConfigSet_Rx_Jigao_BMS_GBT_CEM: UserDefine=false
            Src_CanConfigSet_Rx_Jigao_BMS_GBT_CEM (PduRSrcPdu): PduRSourcePduHandleId=5, PduRSrcModule=CANIF, PduRSrcPduUpTxConf=true, UserDefine=false, PduRSrcPduRef=CanConfigSet_Rx_Jigao_BMS_GBT_CEM
            Dest_CanConfigSet_Rx_Jigao_BMS_GBT_CEM (PduRDestPdu):
              PduRDestPduDataProvision = PDUR_DIRECT
              PduRDestPduHandleId = 0
              PduRTpThreshold = 7
              PduRTransmissionConfirmation = true
              PduRDestModule = COM
              UserDefine = false
              PduRDestPduRef = CanConfigSet_Rx_Jigao_BMS_GBT_CEM
              PduRDestTxBufferRef = /EAS/PduR/PduRRoutingTables/PduRTxBufferTable/PduRTxBuffer/
          CanConfigSet_Rx_Jigao_BMS_GBT_CRO: UserDefine=false
            Src_CanConfigSet_Rx_Jigao_BMS_GBT_CRO (PduRSrcPdu): PduRSourcePduHandleId=6, PduRSrcModule=CANIF, PduRSrcPduUpTxConf=true, UserDefine=false, PduRSrcPduRef=CanConfigSet_Rx_Jigao_BMS_GBT_CRO
            Dest_CanConfigSet_Rx_Jigao_BMS_GBT_CRO (PduRDestPdu):
              PduRDestPduDataProvision = PDUR_DIRECT
              PduRDestPduHandleId = 0
              PduRTpThreshold = 7
              PduRTransmissionConfirmation = true
              PduRDestModule = COM
              UserDefine = false
              PduRDestPduRef = CanConfigSet_Rx_Jigao_BMS_GBT_CRO
              PduRDestTxBufferRef = /EAS/PduR/PduRRoutingTables/PduRTxBufferTable/PduRTxBuffer/
          CanConfigSet_Rx_Jigao_BMS_GBT_CST: UserDefine=false
            Src_CanConfigSet_Rx_Jigao_BMS_GBT_CST (PduRSrcPdu): PduRSourcePduHandleId=7, PduRSrcModule=CANIF, PduRSrcPduUpTxConf=true, UserDefine=false, PduRSrcPduRef=CanConfigSet_Rx_Jigao_BMS_GBT_CST
            Dest_CanConfigSet_Rx_Jigao_BMS_GBT_CST (PduRDestPdu):
              PduRDestPduDataProvision = PDUR_DIRECT
              PduRDestPduHandleId = 0
              PduRTpThreshold = 7
              PduRTransmissionConfirmation = true
              PduRDestModule = COM
              UserDefine = false
              PduRDestPduRef = CanConfigSet_Rx_Jigao_BMS_GBT_CST
              PduRDestTxBufferRef = /EAS/PduR/PduRRoutingTables/PduRTxBufferTable/PduRTxBuffer/
          CanConfigSet_Rx_Jigao_BMS_GBT_CRM: UserDefine=false
            Src_CanConfigSet_Rx_Jigao_BMS_GBT_CRM (PduRSrcPdu): PduRSourcePduHandleId=8, PduRSrcModule=CANIF, PduRSrcPduUpTxConf=true, UserDefine=false, PduRSrcPduRef=CanConfigSet_Rx_Jigao_BMS_GBT_CRM
            Dest_CanConfigSet_Rx_Jigao_BMS_GBT_CRM (PduRDestPdu):
              PduRDestPduDataProvision = PDUR_DIRECT
              PduRDestPduHandleId = 0
              PduRTpThreshold = 7
              PduRTransmissionConfirmation = true
              PduRDestModule = COM
              UserDefine = false
              PduRDestPduRef = CanConfigSet_Rx_Jigao_BMS_GBT_CRM
              PduRDestTxBufferRef = /EAS/PduR/PduRRoutingTables/PduRTxBufferTable/PduRTxBuffer/
          CanConfigSet_Rx_Jigao_BMS_GBT_CTS: UserDefine=false
            Src_CanConfigSet_Rx_Jigao_BMS_GBT_CTS (PduRSrcPdu): PduRSourcePduHandleId=9, PduRSrcModule=CANIF, PduRSrcPduUpTxConf=true, UserDefine=false, PduRSrcPduRef=CanConfigSet_Rx_Jigao_BMS_GBT_CTS
            Dest_CanConfigSet_Rx_Jigao_BMS_GBT_CTS (PduRDestPdu):
              PduRDestPduDataProvision = PDUR_DIRECT
              PduRDestPduHandleId = 0
              PduRTpThreshold = 7
              PduRTransmissionConfirmation = true
              PduRDestModule = COM
              UserDefine = false
              PduRDestPduRef = CanConfigSet_Rx_Jigao_BMS_GBT_CTS
              PduRDestTxBufferRef = /EAS/PduR/PduRRoutingTables/PduRTxBufferTable/PduRTxBuffer/
          CanConfigSet_Rx_Jigao_BMS_GBT_CML: UserDefine=false
            Src_CanConfigSet_Rx_Jigao_BMS_GBT_CML (PduRSrcPdu): PduRSourcePduHandleId=10, PduRSrcModule=CANIF, PduRSrcPduUpTxConf=true, UserDefine=false, PduRSrcPduRef=CanConfigSet_Rx_Jigao_BMS_GBT_CML
            Dest_CanConfigSet_Rx_Jigao_BMS_GBT_CML (PduRDestPdu):
              PduRDestPduDataProvision = PDUR_DIRECT
              PduRDestPduHandleId = 0
              PduRTpThreshold = 7
              PduRTransmissionConfirmation = true
              PduRDestModule = COM
              UserDefine = false
              PduRDestPduRef = CanConfigSet_Rx_Jigao_BMS_GBT_CML
              PduRDestTxBufferRef = /EAS/PduR/PduRRoutingTables/PduRTxBufferTable/PduRTxBuffer/
          CanConfigSet_Rx_Jigao_BMS_GBT_CCS: UserDefine=false
            Src_CanConfigSet_Rx_Jigao_BMS_GBT_CCS (PduRSrcPdu): PduRSourcePduHandleId=11, PduRSrcModule=CANIF, PduRSrcPduUpTxConf=true, UserDefine=false, PduRSrcPduRef=CanConfigSet_Rx_Jigao_BMS_GBT_CCS
            Dest_CanConfigSet_Rx_Jigao_BMS_GBT_CCS (PduRDestPdu):
              PduRDestPduDataProvision = PDUR_DIRECT
              PduRDestPduHandleId = 0
              PduRTpThreshold = 7
              PduRTransmissionConfirmation = true
              PduRDestModule = COM
              UserDefine = false
              PduRDestPduRef = CanConfigSet_Rx_Jigao_BMS_GBT_CCS
              PduRDestTxBufferRef = /EAS/PduR/PduRRoutingTables/PduRTxBufferTable/PduRTxBuffer/
          CanConfigSet_Rx_Jigao_BMS_GBT_CSD: UserDefine=false
            Src_CanConfigSet_Rx_Jigao_BMS_GBT_CSD (PduRSrcPdu): PduRSourcePduHandleId=12, PduRSrcModule=CANIF, PduRSrcPduUpTxConf=true, UserDefine=false, PduRSrcPduRef=CanConfigSet_Rx_Jigao_BMS_GBT_CSD
            Dest_CanConfigSet_Rx_Jigao_BMS_GBT_CSD (PduRDestPdu):
              PduRDestPduDataProvision = PDUR_DIRECT
              PduRDestPduHandleId = 0
              PduRTpThreshold = 7
              PduRTransmissionConfirmation = true
              PduRDestModule = COM
              UserDefine = false
              PduRDestPduRef = CanConfigSet_Rx_Jigao_BMS_GBT_CSD
              PduRDestTxBufferRef = /EAS/PduR/PduRRoutingTables/PduRTxBufferTable/PduRTxBuffer/
          CanConfigSet_Rx_Jigao_BMS_GBT_CHM: UserDefine=false
            Src_CanConfigSet_Rx_Jigao_BMS_GBT_CHM (PduRSrcPdu): PduRSourcePduHandleId=13, PduRSrcModule=CANIF, PduRSrcPduUpTxConf=true, UserDefine=false, PduRSrcPduRef=CanConfigSet_Rx_Jigao_BMS_GBT_CHM
            Dest_CanConfigSet_Rx_Jigao_BMS_GBT_CHM (PduRDestPdu):
              PduRDestPduDataProvision = PDUR_DIRECT
              PduRDestPduHandleId = 0
              PduRTpThreshold = 7
              PduRTransmissionConfirmation = true
              PduRDestModule = COM
              UserDefine = false
              PduRDestPduRef = CanConfigSet_Rx_Jigao_BMS_GBT_CHM
              PduRDestTxBufferRef = /EAS/PduR/PduRRoutingTables/PduRTxBufferTable/PduRTxBuffer/
          CanConfigSet_Rx_CAN_Network_PMS_HVFunctionCtrl: UserDefine=false
            Src_CanConfigSet_Rx_CAN_Network_PMS_HVFunctionCtrl (PduRSrcPdu):
              PduRSourcePduHandleId = 14
              PduRSrcModule = CANIF
              PduRSrcPduUpTxConf = true
              UserDefine = false
              PduRSrcPduRef = CanConfigSet_Rx_CAN_Network_PMS_HVFunctionCtrl
            Dest_CanConfigSet_Rx_CAN_Network_PMS_HVFunctionCtrl (PduRDestPdu):
              PduRDestPduDataProvision = PDUR_DIRECT
              PduRDestPduHandleId = 0
              PduRTpThreshold = 7
              PduRTransmissionConfirmation = true
              PduRDestModule = COM
              UserDefine = false
              PduRDestPduRef = CanConfigSet_Rx_CAN_Network_PMS_HVFunctionCtrl
              PduRDestTxBufferRef = /EAS/PduR/PduRRoutingTables/PduRTxBufferTable/PduRTxBuffer/
          CanConfigSet_Rx_CAN_Network_PMS_BodyControlInfo: UserDefine=false
            Src_CanConfigSet_Rx_CAN_Network_PMS_BodyControlInfo (PduRSrcPdu):
              PduRSourcePduHandleId = 15
              PduRSrcModule = CANIF
              PduRSrcPduUpTxConf = true
              UserDefine = false
              PduRSrcPduRef = CanConfigSet_Rx_CAN_Network_PMS_BodyControlInfo
            Dest_CanConfigSet_Rx_CAN_Network_PMS_BodyControlInfo (PduRDestPdu):
              PduRDestPduDataProvision = PDUR_DIRECT
              PduRDestPduHandleId = 0
              PduRTpThreshold = 7
              PduRTransmissionConfirmation = true
              PduRDestModule = COM
              UserDefine = false
              PduRDestPduRef = CanConfigSet_Rx_CAN_Network_PMS_BodyControlInfo
              PduRDestTxBufferRef = /EAS/PduR/PduRRoutingTables/PduRTxBufferTable/PduRTxBuffer/
          CanConfigSet_Rx_CAN_Network_PMS_PTInfoIndicate: UserDefine=false
            Src_CanConfigSet_Rx_CAN_Network_PMS_PTInfoIndicate (PduRSrcPdu):
              PduRSourcePduHandleId = 16
              PduRSrcModule = CANIF
              PduRSrcPduUpTxConf = true
              UserDefine = false
              PduRSrcPduRef = CanConfigSet_Rx_CAN_Network_PMS_PTInfoIndicate
            Dest_CanConfigSet_Rx_CAN_Network_PMS_PTInfoIndicate (PduRDestPdu):
              PduRDestPduDataProvision = PDUR_DIRECT
              PduRDestPduHandleId = 0
              PduRTpThreshold = 7
              PduRTransmissionConfirmation = true
              PduRDestModule = COM
              UserDefine = false
              PduRDestPduRef = CanConfigSet_Rx_CAN_Network_PMS_PTInfoIndicate
              PduRDestTxBufferRef = /EAS/PduR/PduRRoutingTables/PduRTxBufferTable/PduRTxBuffer/
          CanConfigSet_Rx_Jigao_BMS_GBT_CDC: UserDefine=false
            Src_CanConfigSet_Rx_Jigao_BMS_GBT_CDC (PduRSrcPdu): PduRSourcePduHandleId=17, PduRSrcModule=CANIF, PduRSrcPduUpTxConf=true, UserDefine=false, PduRSrcPduRef=CanConfigSet_Rx_Jigao_BMS_GBT_CDC
            Dest_CanConfigSet_Rx_Jigao_BMS_GBT_CDC (PduRDestPdu):
              PduRDestPduDataProvision = PDUR_DIRECT
              PduRDestPduHandleId = 0
              PduRTpThreshold = 7
              PduRTransmissionConfirmation = true
              PduRDestModule = COM
              UserDefine = false
              PduRDestPduRef = CanConfigSet_Rx_Jigao_BMS_GBT_CDC
              PduRDestTxBufferRef = /EAS/PduR/PduRRoutingTables/PduRTxBufferTable/PduRTxBuffer/
          CanConfigSet_Rx_Jigao_BMS_GBT_CMLP: UserDefine=false
            Src_CanConfigSet_Rx_Jigao_BMS_GBT_CMLP (PduRSrcPdu): PduRSourcePduHandleId=18, PduRSrcModule=CANIF, PduRSrcPduUpTxConf=true, UserDefine=false, PduRSrcPduRef=CanConfigSet_Rx_Jigao_BMS_GBT_CMLP
            Dest_CanConfigSet_Rx_Jigao_BMS_GBT_CMLP (PduRDestPdu):
              PduRDestPduDataProvision = PDUR_DIRECT
              PduRDestPduHandleId = 0
              PduRTpThreshold = 7
              PduRTransmissionConfirmation = true
              PduRDestModule = COM
              UserDefine = false
              PduRDestPduRef = CanConfigSet_Rx_Jigao_BMS_GBT_CMLP
              PduRDestTxBufferRef = /EAS/PduR/PduRRoutingTables/PduRTxBufferTable/PduRTxBuffer/
          CanConfigSet_Rx_Jigao_BMS_GBT_CCD: UserDefine=false
            Src_CanConfigSet_Rx_Jigao_BMS_GBT_CCD (PduRSrcPdu): PduRSourcePduHandleId=19, PduRSrcModule=CANIF, PduRSrcPduUpTxConf=true, UserDefine=false, PduRSrcPduRef=CanConfigSet_Rx_Jigao_BMS_GBT_CCD
            Dest_CanConfigSet_Rx_Jigao_BMS_GBT_CCD (PduRDestPdu):
              PduRDestPduDataProvision = PDUR_DIRECT
              PduRDestPduHandleId = 0
              PduRTpThreshold = 7
              PduRTransmissionConfirmation = true
              PduRDestModule = COM
              UserDefine = false
              PduRDestPduRef = CanConfigSet_Rx_Jigao_BMS_GBT_CCD
              PduRDestTxBufferRef = /EAS/PduR/PduRRoutingTables/PduRTxBufferTable/PduRTxBuffer/
          CanConfigSet_Rx_Jigao_BMS_GBT_CSDP: UserDefine=false
            Src_CanConfigSet_Rx_Jigao_BMS_GBT_CSDP (PduRSrcPdu): PduRSourcePduHandleId=20, PduRSrcModule=CANIF, PduRSrcPduUpTxConf=true, UserDefine=false, PduRSrcPduRef=CanConfigSet_Rx_Jigao_BMS_GBT_CSDP
            Dest_CanConfigSet_Rx_Jigao_BMS_GBT_CSDP (PduRDestPdu):
              PduRDestPduDataProvision = PDUR_DIRECT
              PduRDestPduHandleId = 0
              PduRTpThreshold = 7
              PduRTransmissionConfirmation = true
              PduRDestModule = COM
              UserDefine = false
              PduRDestPduRef = CanConfigSet_Rx_Jigao_BMS_GBT_CSDP
              PduRDestTxBufferRef = /EAS/PduR/PduRRoutingTables/PduRTxBufferTable/PduRTxBuffer/
          CanConfigSet_Rx_CAN_Network_HCM_WorkInfo: UserDefine=false
            Src_CanConfigSet_Rx_CAN_Network_HCM_WorkInfo (PduRSrcPdu): PduRSourcePduHandleId=21, PduRSrcModule=CANIF, PduRSrcPduUpTxConf=true, UserDefine=false, PduRSrcPduRef=CanConfigSet_Rx_CAN_Network_HCM_WorkInfo
            Dest_CanConfigSet_Rx_CAN_Network_HCM_WorkInfo (PduRDestPdu):
              PduRDestPduDataProvision = PDUR_DIRECT
              PduRDestPduHandleId = 0
              PduRTpThreshold = 7
              PduRTransmissionConfirmation = true
              PduRDestModule = COM
              UserDefine = false
              PduRDestPduRef = CanConfigSet_Rx_CAN_Network_HCM_WorkInfo
              PduRDestTxBufferRef = /EAS/PduR/PduRRoutingTables/PduRTxBufferTable/PduRTxBuffer/
          CanConfigSet_Rx_CAN_Network_HCM_Status: UserDefine=false
            Src_CanConfigSet_Rx_CAN_Network_HCM_Status (PduRSrcPdu): PduRSourcePduHandleId=22, PduRSrcModule=CANIF, PduRSrcPduUpTxConf=true, UserDefine=false, PduRSrcPduRef=CanConfigSet_Rx_CAN_Network_HCM_Status
            Dest_CanConfigSet_Rx_CAN_Network_HCM_Status (PduRDestPdu):
              PduRDestPduDataProvision = PDUR_DIRECT
              PduRDestPduHandleId = 0
              PduRTpThreshold = 7
              PduRTransmissionConfirmation = true
              PduRDestModule = COM
              UserDefine = false
              PduRDestPduRef = CanConfigSet_Rx_CAN_Network_HCM_Status
              PduRDestTxBufferRef = /EAS/PduR/PduRRoutingTables/PduRTxBufferTable/PduRTxBuffer/
          CanConfigSet_Rx_CAN_Network_PMS_HVFunctionCtrl2: UserDefine=false
            Src_CanConfigSet_Rx_CAN_Network_PMS_HVFunctionCtrl2 (PduRSrcPdu):
              PduRSourcePduHandleId = 23
              PduRSrcModule = CANIF
              PduRSrcPduUpTxConf = true
              UserDefine = false
              PduRSrcPduRef = CanConfigSet_Rx_CAN_Network_PMS_HVFunctionCtrl2
            Dest_CanConfigSet_Rx_CAN_Network_PMS_HVFunctionCtrl2 (PduRDestPdu):
              PduRDestPduDataProvision = PDUR_DIRECT
              PduRDestPduHandleId = 0
              PduRTpThreshold = 7
              PduRTransmissionConfirmation = true
              PduRDestModule = COM
              UserDefine = false
              PduRDestPduRef = CanConfigSet_Rx_CAN_Network_PMS_HVFunctionCtrl2
              PduRDestTxBufferRef = /EAS/PduR/PduRRoutingTables/PduRTxBufferTable/PduRTxBuffer/
          CanConfigSet_Rx_CAN_Network_PMS_PMSCtrl: UserDefine=false
            Src_CanConfigSet_Rx_CAN_Network_PMS_PMSCtrl (PduRSrcPdu): PduRSourcePduHandleId=24, PduRSrcModule=CANIF, PduRSrcPduUpTxConf=true, UserDefine=false, PduRSrcPduRef=CanConfigSet_Rx_CAN_Network_PMS_PMSCtrl
            Dest_CanConfigSet_Rx_CAN_Network_PMS_PMSCtrl (PduRDestPdu):
              PduRDestPduDataProvision = PDUR_DIRECT
              PduRDestPduHandleId = 0
              PduRTpThreshold = 7
              PduRTransmissionConfirmation = true
              PduRDestModule = COM
              UserDefine = false
              PduRDestPduRef = CanConfigSet_Rx_CAN_Network_PMS_PMSCtrl
              PduRDestTxBufferRef = /EAS/PduR/PduRRoutingTables/PduRTxBufferTable/PduRTxBuffer/
          CanConfigSet_Rx_CAN_Network_MCU_BodyControlInfo: UserDefine=false
            Src_CanConfigSet_Rx_CAN_Network_MCU_BodyControlInfo (PduRSrcPdu):
              PduRSourcePduHandleId = 25
              PduRSrcModule = CANIF
              PduRSrcPduUpTxConf = true
              UserDefine = false
              PduRSrcPduRef = CanConfigSet_Rx_CAN_Network_MCU_BodyControlInfo
            Dest_CanConfigSet_Rx_CAN_Network_MCU_BodyControlInfo (PduRDestPdu):
              PduRDestPduDataProvision = PDUR_DIRECT
              PduRDestPduHandleId = 0
              PduRTpThreshold = 7
              PduRTransmissionConfirmation = true
              PduRDestModule = COM
              UserDefine = false
              PduRDestPduRef = CanConfigSet_Rx_CAN_Network_MCU_BodyControlInfo
              PduRDestTxBufferRef = /EAS/PduR/PduRRoutingTables/PduRTxBufferTable/PduRTxBuffer/
          CanConfigSet_Rx_CAN_Network_EMS_EngineRPM: UserDefine=false
            Src_CanConfigSet_Rx_CAN_Network_EMS_EngineRPM (PduRSrcPdu): PduRSourcePduHandleId=26, PduRSrcModule=CANIF, PduRSrcPduUpTxConf=true, UserDefine=false, PduRSrcPduRef=CanConfigSet_Rx_CAN_Network_EMS_EngineRPM
            Dest_CanConfigSet_Rx_CAN_Network_EMS_EngineRPM (PduRDestPdu):
              PduRDestPduDataProvision = PDUR_DIRECT
              PduRDestPduHandleId = 0
              PduRTpThreshold = 7
              PduRTransmissionConfirmation = true
              PduRDestModule = COM
              UserDefine = false
              PduRDestPduRef = CanConfigSet_Rx_CAN_Network_EMS_EngineRPM
              PduRDestTxBufferRef = /EAS/PduR/PduRRoutingTables/PduRTxBufferTable/PduRTxBuffer/
          CanConfigSet_Rx_CAN_Network_EMS_EngineDriverInfo: UserDefine=false
            Src_CanConfigSet_Rx_CAN_Network_EMS_EngineDriverInfo (PduRSrcPdu):
              PduRSourcePduHandleId = 27
              PduRSrcModule = CANIF
              PduRSrcPduUpTxConf = true
              UserDefine = false
              PduRSrcPduRef = CanConfigSet_Rx_CAN_Network_EMS_EngineDriverInfo
            Dest_CanConfigSet_Rx_CAN_Network_EMS_EngineDriverInfo (PduRDestPdu):
              PduRDestPduDataProvision = PDUR_DIRECT
              PduRDestPduHandleId = 0
              PduRTpThreshold = 7
              PduRTransmissionConfirmation = true
              PduRDestModule = COM
              UserDefine = false
              PduRDestPduRef = CanConfigSet_Rx_CAN_Network_EMS_EngineDriverInfo
              PduRDestTxBufferRef = /EAS/PduR/PduRRoutingTables/PduRTxBufferTable/PduRTxBuffer/
          CanConfigSet_Rx_CAN_Network_MCU_PTInfoIndicate: UserDefine=false
            Src_CanConfigSet_Rx_CAN_Network_MCU_PTInfoIndicate (PduRSrcPdu):
              PduRSourcePduHandleId = 28
              PduRSrcModule = CANIF
              PduRSrcPduUpTxConf = true
              UserDefine = false
              PduRSrcPduRef = CanConfigSet_Rx_CAN_Network_MCU_PTInfoIndicate
            Dest_CanConfigSet_Rx_CAN_Network_MCU_PTInfoIndicate (PduRDestPdu):
              PduRDestPduDataProvision = PDUR_DIRECT
              PduRDestPduHandleId = 0
              PduRTpThreshold = 7
              PduRTransmissionConfirmation = true
              PduRDestModule = COM
              UserDefine = false
              PduRDestPduRef = CanConfigSet_Rx_CAN_Network_MCU_PTInfoIndicate
              PduRDestTxBufferRef = /EAS/PduR/PduRRoutingTables/PduRTxBufferTable/PduRTxBuffer/
          CanConfigSet_Rx_CAN_Network_ACU_Status: UserDefine=false
            Src_CanConfigSet_Rx_CAN_Network_ACU_Status (PduRSrcPdu): PduRSourcePduHandleId=29, PduRSrcModule=CANIF, PduRSrcPduUpTxConf=true, UserDefine=false, PduRSrcPduRef=CanConfigSet_Rx_CAN_Network_ACU_Status
            Dest_CanConfigSet_Rx_CAN_Network_ACU_Status (PduRDestPdu):
              PduRDestPduDataProvision = PDUR_DIRECT
              PduRDestPduHandleId = 0
              PduRTpThreshold = 7
              PduRTransmissionConfirmation = true
              PduRDestModule = COM
              UserDefine = false
              PduRDestPduRef = CanConfigSet_Rx_CAN_Network_ACU_Status
              PduRDestTxBufferRef = /EAS/PduR/PduRRoutingTables/PduRTxBufferTable/PduRTxBuffer/
          CanConfigSet_Rx_CAN_Network_BBM_infor: UserDefine=false
            Src_CanConfigSet_Rx_CAN_Network_BBM_infor (PduRSrcPdu): PduRSourcePduHandleId=30, PduRSrcModule=CANIF, PduRSrcPduUpTxConf=true, UserDefine=false, PduRSrcPduRef=CanConfigSet_Rx_CAN_Network_BBM_infor
            Dest_CanConfigSet_Rx_CAN_Network_BBM_infor (PduRDestPdu):
              PduRDestPduDataProvision = PDUR_DIRECT
              PduRDestPduHandleId = 0
              PduRTpThreshold = 7
              PduRTransmissionConfirmation = true
              PduRDestModule = COM
              UserDefine = false
              PduRDestPduRef = CanConfigSet_Rx_CAN_Network_BBM_infor
              PduRDestTxBufferRef = /EAS/PduR/PduRRoutingTables/PduRTxBufferTable/PduRTxBuffer/
          CanConfigSet_Rx_CAN_Network_AC_ThermalReq: UserDefine=false
            Src_CanConfigSet_Rx_CAN_Network_AC_ThermalReq (PduRSrcPdu): PduRSourcePduHandleId=31, PduRSrcModule=CANIF, PduRSrcPduUpTxConf=true, UserDefine=false, PduRSrcPduRef=CanConfigSet_Rx_CAN_Network_AC_ThermalReq
            Dest_CanConfigSet_Rx_CAN_Network_AC_ThermalReq (PduRDestPdu):
              PduRDestPduDataProvision = PDUR_DIRECT
              PduRDestPduHandleId = 0
              PduRTpThreshold = 7
              PduRTransmissionConfirmation = true
              PduRDestModule = COM
              UserDefine = false
              PduRDestPduRef = CanConfigSet_Rx_CAN_Network_AC_ThermalReq
              PduRDestTxBufferRef = /EAS/PduR/PduRRoutingTables/PduRTxBufferTable/PduRTxBuffer/
          CanConfigSet_Rx_CAN_Network_AC_PTC_ACCM_Infor: UserDefine=false
            Src_CanConfigSet_Rx_CAN_Network_AC_PTC_ACCM_Infor (PduRSrcPdu):
              PduRSourcePduHandleId = 32
              PduRSrcModule = CANIF
              PduRSrcPduUpTxConf = true
              UserDefine = false
              PduRSrcPduRef = CanConfigSet_Rx_CAN_Network_AC_PTC_ACCM_Infor
            Dest_CanConfigSet_Rx_CAN_Network_AC_PTC_ACCM_Infor (PduRDestPdu):
              PduRDestPduDataProvision = PDUR_DIRECT
              PduRDestPduHandleId = 0
              PduRTpThreshold = 7
              PduRTransmissionConfirmation = true
              PduRDestModule = COM
              UserDefine = false
              PduRDestPduRef = CanConfigSet_Rx_CAN_Network_AC_PTC_ACCM_Infor
              PduRDestTxBufferRef = /EAS/PduR/PduRRoutingTables/PduRTxBufferTable/PduRTxBuffer/
          CanConfigSet_Rx_CAN_Network_PMS_BatterySwap: UserDefine=false
            Src_CanConfigSet_Rx_CAN_Network_PMS_BatterySwap (PduRSrcPdu): PduRSourcePduHandleId=33, PduRSrcModule=CANIF, PduRSrcPduUpTxConf=true, UserDefine=false, PduRSrcPduRef=CanConfigSet_Rx_CAN_Network_PMS_BatterySwap
            Dest_CanConfigSet_Rx_CAN_Network_PMS_BatterySwap (PduRDestPdu):
              PduRDestPduDataProvision = PDUR_DIRECT
              PduRDestPduHandleId = 0
              PduRTpThreshold = 7
              PduRTransmissionConfirmation = true
              PduRDestModule = COM
              UserDefine = false
              PduRDestPduRef = CanConfigSet_Rx_CAN_Network_PMS_BatterySwap
              PduRDestTxBufferRef = /EAS/PduR/PduRRoutingTables/PduRTxBufferTable/PduRTxBuffer/
          CanConfigSet_Rx_CAN_Network_EMS_OBD_Info: UserDefine=false
            Src_CanConfigSet_Rx_CAN_Network_EMS_OBD_Info (PduRSrcPdu): PduRSourcePduHandleId=34, PduRSrcModule=CANIF, PduRSrcPduUpTxConf=true, UserDefine=false, PduRSrcPduRef=CanConfigSet_Rx_CAN_Network_EMS_OBD_Info
            Dest_CanConfigSet_Rx_CAN_Network_EMS_OBD_Info (PduRDestPdu):
              PduRDestPduDataProvision = PDUR_DIRECT
              PduRDestPduHandleId = 0
              PduRTpThreshold = 7
              PduRTransmissionConfirmation = true
              PduRDestModule = COM
              UserDefine = false
              PduRDestPduRef = CanConfigSet_Rx_CAN_Network_EMS_OBD_Info
              PduRDestTxBufferRef = /EAS/PduR/PduRRoutingTables/PduRTxBufferTable/PduRTxBuffer/
          CanConfigSet_Rx_CAN_Network_PMS_ACCtrl: UserDefine=false
            Src_CanConfigSet_Rx_CAN_Network_PMS_ACCtrl (PduRSrcPdu): PduRSourcePduHandleId=35, PduRSrcModule=CANIF, PduRSrcPduUpTxConf=true, UserDefine=false, PduRSrcPduRef=CanConfigSet_Rx_CAN_Network_PMS_ACCtrl
            Dest_CanConfigSet_Rx_CAN_Network_PMS_ACCtrl (PduRDestPdu):
              PduRDestPduDataProvision = PDUR_DIRECT
              PduRDestPduHandleId = 0
              PduRTpThreshold = 7
              PduRTransmissionConfirmation = true
              PduRDestModule = COM
              UserDefine = false
              PduRDestPduRef = CanConfigSet_Rx_CAN_Network_PMS_ACCtrl
              PduRDestTxBufferRef = /EAS/PduR/PduRRoutingTables/PduRTxBufferTable/PduRTxBuffer/
          CanConfigSet_Rx_CAN_Network_PMS_OBD_RequireInfo: UserDefine=false
            Src_CanConfigSet_Rx_CAN_Network_PMS_OBD_RequireInfo (PduRSrcPdu):
              PduRSourcePduHandleId = 36
              PduRSrcModule = CANIF
              PduRSrcPduUpTxConf = true
              UserDefine = false
              PduRSrcPduRef = CanConfigSet_Rx_CAN_Network_PMS_OBD_RequireInfo
            Dest_CanConfigSet_Rx_CAN_Network_PMS_OBD_RequireInfo (PduRDestPdu):
              PduRDestPduDataProvision = PDUR_DIRECT
              PduRDestPduHandleId = 0
              PduRTpThreshold = 7
              PduRTransmissionConfirmation = true
              PduRDestModule = COM
              UserDefine = false
              PduRDestPduRef = CanConfigSet_Rx_CAN_Network_PMS_OBD_RequireInfo
              PduRDestTxBufferRef = /EAS/PduR/PduRRoutingTables/PduRTxBufferTable/PduRTxBuffer/
          CanConfigSet_Rx_CAN_Network_OBC_GeneralSts1: UserDefine=false
            Src_CanConfigSet_Rx_CAN_Network_OBC_GeneralSts1 (PduRSrcPdu): PduRSourcePduHandleId=37, PduRSrcModule=CANIF, PduRSrcPduUpTxConf=true, UserDefine=false, PduRSrcPduRef=CanConfigSet_Rx_CAN_Network_OBC_GeneralSts1
            Dest_CanConfigSet_Rx_CAN_Network_OBC_GeneralSts1 (PduRDestPdu):
              PduRDestPduDataProvision = PDUR_DIRECT
              PduRDestPduHandleId = 0
              PduRTpThreshold = 7
              PduRTransmissionConfirmation = true
              PduRDestModule = COM
              UserDefine = false
              PduRDestPduRef = CanConfigSet_Rx_CAN_Network_OBC_GeneralSts1
              PduRDestTxBufferRef = /EAS/PduR/PduRRoutingTables/PduRTxBufferTable/PduRTxBuffer/
          CanConfigSet_Rx_CAN_Network_IC_VDHR: UserDefine=false
            Src_CanConfigSet_Rx_CAN_Network_IC_VDHR (PduRSrcPdu): PduRSourcePduHandleId=38, PduRSrcModule=CANIF, PduRSrcPduUpTxConf=true, UserDefine=false, PduRSrcPduRef=CanConfigSet_Rx_CAN_Network_IC_VDHR
            Dest_CanConfigSet_Rx_CAN_Network_IC_VDHR (PduRDestPdu):
              PduRDestPduDataProvision = PDUR_DIRECT
              PduRDestPduHandleId = 0
              PduRTpThreshold = 7
              PduRTransmissionConfirmation = true
              PduRDestModule = COM
              UserDefine = false
              PduRDestPduRef = CanConfigSet_Rx_CAN_Network_IC_VDHR
              PduRDestTxBufferRef = /EAS/PduR/PduRRoutingTables/PduRTxBufferTable/PduRTxBuffer/
          CanConfigSet_Rx_CAN_Network_ACCM_Status: UserDefine=false
            Src_CanConfigSet_Rx_CAN_Network_ACCM_Status (PduRSrcPdu): PduRSourcePduHandleId=39, PduRSrcModule=CANIF, PduRSrcPduUpTxConf=true, UserDefine=false, PduRSrcPduRef=CanConfigSet_Rx_CAN_Network_ACCM_Status
            Dest_CanConfigSet_Rx_CAN_Network_ACCM_Status (PduRDestPdu):
              PduRDestPduDataProvision = PDUR_DIRECT
              PduRDestPduHandleId = 0
              PduRTpThreshold = 7
              PduRTransmissionConfirmation = true
              PduRDestModule = COM
              UserDefine = false
              PduRDestPduRef = CanConfigSet_Rx_CAN_Network_ACCM_Status
              PduRDestTxBufferRef = /EAS/PduR/PduRRoutingTables/PduRTxBufferTable/PduRTxBuffer/
          PMS_EnyInfo: UserDefine=true
            Src_PMS_EnyInfo (PduRSrcPdu): PduRSourcePduHandleId=40, PduRSrcModule=CANIF, PduRSrcPduUpTxConf=true, UserDefine=false, PduRSrcPduRef=PMS_EnyInfo
            Dest_PMS_EnyInfo (PduRDestPdu):
              PduRDestPduDataProvision = PDUR_DIRECT
              PduRDestPduHandleId = 0
              PduRTpThreshold = 7
              PduRTransmissionConfirmation = true
              PduRDestModule = COM
              UserDefine = false
              PduRDestPduRef = PMS_EnyInfo
              PduRDestTxBufferRef = /EAS/PduR/PduRRoutingTables/PduRTxBufferTable/PduRTxBuffer/
          CanIfTxPduTest: UserDefine=true
            Src_CanIfTxPduTest (PduRSrcPdu): PduRSourcePduHandleId=41, PduRSrcModule=COM, PduRSrcPduUpTxConf=true, UserDefine=false, PduRSrcPduRef=CanIfTxPduTest
            Dest_CanIfTxPduTest (PduRDestPdu):
              PduRDestPduDataProvision = PDUR_DIRECT
              PduRDestPduHandleId = 0
              PduRTpThreshold = 7
              PduRTransmissionConfirmation = true
              PduRDestModule = CANIF
              UserDefine = false
              PduRDestPduRef = CanIfTxPduTest
              PduRDestTxBufferRef = /EAS/PduR/PduRRoutingTables/PduRTxBufferTable/PduRTxBuffer/
          CanConfigSet_Tx_CAN_Network_BMS_CellVoltData24: UserDefine=false
            Src_CanConfigSet_Tx_CAN_Network_BMS_CellVoltData24 (PduRSrcPdu): PduRSourcePduHandleId=42, PduRSrcModule=COM, PduRSrcPduUpTxConf=true, UserDefine=false, PduRSrcPduRef=CanConfigSet_Tx_CAN_Network_BMS_CellVoltData24
            Dest_CanConfigSet_Tx_CAN_Network_BMS_CellVoltData24 (PduRDestPdu):
              PduRDestPduDataProvision = PDUR_DIRECT
              PduRDestPduHandleId = 0
              PduRTpThreshold = 7
              PduRTransmissionConfirmation = true
              PduRDestModule = CANIF
              UserDefine = false
              PduRDestPduRef = CanConfigSet_Tx_CAN_Network_BMS_CellVoltData24
              PduRDestTxBufferRef = /EAS/PduR/PduRRoutingTables/PduRTxBufferTable/PduRTxBuffer/
          CanConfigSet_Tx_CAN_Network_BMS_CellVoltData23: UserDefine=false
            Src_CanConfigSet_Tx_CAN_Network_BMS_CellVoltData23 (PduRSrcPdu): PduRSourcePduHandleId=43, PduRSrcModule=COM, PduRSrcPduUpTxConf=true, UserDefine=false, PduRSrcPduRef=CanConfigSet_Tx_CAN_Network_BMS_CellVoltData23
            Dest_CanConfigSet_Tx_CAN_Network_BMS_CellVoltData23 (PduRDestPdu):
              PduRDestPduDataProvision = PDUR_DIRECT
              PduRDestPduHandleId = 0
              PduRTpThreshold = 7
              PduRTransmissionConfirmation = true
              PduRDestModule = CANIF
              UserDefine = false
              PduRDestPduRef = CanConfigSet_Tx_CAN_Network_BMS_CellVoltData23
              PduRDestTxBufferRef = /EAS/PduR/PduRRoutingTables/PduRTxBufferTable/PduRTxBuffer/
          CanConfigSet_Tx_CAN_Network_BMS_CellVoltData22: UserDefine=false
            Src_CanConfigSet_Tx_CAN_Network_BMS_CellVoltData22 (PduRSrcPdu): PduRSourcePduHandleId=44, PduRSrcModule=COM, PduRSrcPduUpTxConf=true, UserDefine=false, PduRSrcPduRef=CanConfigSet_Tx_CAN_Network_BMS_CellVoltData22
            Dest_CanConfigSet_Tx_CAN_Network_BMS_CellVoltData22 (PduRDestPdu):
              PduRDestPduDataProvision = PDUR_DIRECT
              PduRDestPduHandleId = 0
              PduRTpThreshold = 7
              PduRTransmissionConfirmation = true
              PduRDestModule = CANIF
              UserDefine = false
              PduRDestPduRef = CanConfigSet_Tx_CAN_Network_BMS_CellVoltData22
              PduRDestTxBufferRef = /EAS/PduR/PduRRoutingTables/PduRTxBufferTable/PduRTxBuffer/
          CanConfigSet_Tx_CAN_Network_BMS_CellVoltData21: UserDefine=false
            Src_CanConfigSet_Tx_CAN_Network_BMS_CellVoltData21 (PduRSrcPdu): PduRSourcePduHandleId=45, PduRSrcModule=COM, PduRSrcPduUpTxConf=true, UserDefine=false, PduRSrcPduRef=CanConfigSet_Tx_CAN_Network_BMS_CellVoltData21
            Dest_CanConfigSet_Tx_CAN_Network_BMS_CellVoltData21 (PduRDestPdu):
              PduRDestPduDataProvision = PDUR_DIRECT
              PduRDestPduHandleId = 0
              PduRTpThreshold = 7
              PduRTransmissionConfirmation = true
              PduRDestModule = CANIF
              UserDefine = false
              PduRDestPduRef = CanConfigSet_Tx_CAN_Network_BMS_CellVoltData21
              PduRDestTxBufferRef = /EAS/PduR/PduRRoutingTables/PduRTxBufferTable/PduRTxBuffer/
          CanConfigSet_Tx_CAN_Network_BMS_CellVoltData20: UserDefine=false
            Src_CanConfigSet_Tx_CAN_Network_BMS_CellVoltData20 (PduRSrcPdu): PduRSourcePduHandleId=46, PduRSrcModule=COM, PduRSrcPduUpTxConf=true, UserDefine=false, PduRSrcPduRef=CanConfigSet_Tx_CAN_Network_BMS_CellVoltData20
            Dest_CanConfigSet_Tx_CAN_Network_BMS_CellVoltData20 (PduRDestPdu):
              PduRDestPduDataProvision = PDUR_DIRECT
              PduRDestPduHandleId = 0
              PduRTpThreshold = 7
              PduRTransmissionConfirmation = true
              PduRDestModule = CANIF
              UserDefine = false
              PduRDestPduRef = CanConfigSet_Tx_CAN_Network_BMS_CellVoltData20
              PduRDestTxBufferRef = /EAS/PduR/PduRRoutingTables/PduRTxBufferTable/PduRTxBuffer/
          CanConfigSet_Tx_CAN_Network_BMS_CellVoltData19: UserDefine=false
            Src_CanConfigSet_Tx_CAN_Network_BMS_CellVoltData19 (PduRSrcPdu): PduRSourcePduHandleId=47, PduRSrcModule=COM, PduRSrcPduUpTxConf=true, UserDefine=false, PduRSrcPduRef=CanConfigSet_Tx_CAN_Network_BMS_CellVoltData19
            Dest_CanConfigSet_Tx_CAN_Network_BMS_CellVoltData19 (PduRDestPdu):
              PduRDestPduDataProvision = PDUR_DIRECT
              PduRDestPduHandleId = 0
              PduRTpThreshold = 7
              PduRTransmissionConfirmation = true
              PduRDestModule = CANIF
              UserDefine = false
              PduRDestPduRef = CanConfigSet_Tx_CAN_Network_BMS_CellVoltData19
              PduRDestTxBufferRef = /EAS/PduR/PduRRoutingTables/PduRTxBufferTable/PduRTxBuffer/
          CanConfigSet_Tx_CAN_Network_BMS_CellVoltData18: UserDefine=false
            Src_CanConfigSet_Tx_CAN_Network_BMS_CellVoltData18 (PduRSrcPdu): PduRSourcePduHandleId=48, PduRSrcModule=COM, PduRSrcPduUpTxConf=true, UserDefine=false, PduRSrcPduRef=CanConfigSet_Tx_CAN_Network_BMS_CellVoltData18
            Dest_CanConfigSet_Tx_CAN_Network_BMS_CellVoltData18 (PduRDestPdu):
              PduRDestPduDataProvision = PDUR_DIRECT
              PduRDestPduHandleId = 0
              PduRTpThreshold = 7
              PduRTransmissionConfirmation = true
              PduRDestModule = CANIF
              UserDefine = false
              PduRDestPduRef = CanConfigSet_Tx_CAN_Network_BMS_CellVoltData18
              PduRDestTxBufferRef = /EAS/PduR/PduRRoutingTables/PduRTxBufferTable/PduRTxBuffer/
          CanConfigSet_Tx_CAN_Network_BMS_CellVoltData17: UserDefine=false
            Src_CanConfigSet_Tx_CAN_Network_BMS_CellVoltData17 (PduRSrcPdu): PduRSourcePduHandleId=49, PduRSrcModule=COM, PduRSrcPduUpTxConf=true, UserDefine=false, PduRSrcPduRef=CanConfigSet_Tx_CAN_Network_BMS_CellVoltData17
            Dest_CanConfigSet_Tx_CAN_Network_BMS_CellVoltData17 (PduRDestPdu):
              PduRDestPduDataProvision = PDUR_DIRECT
              PduRDestPduHandleId = 0
              PduRTpThreshold = 7
              PduRTransmissionConfirmation = true
              PduRDestModule = CANIF
              UserDefine = false
              PduRDestPduRef = CanConfigSet_Tx_CAN_Network_BMS_CellVoltData17
              PduRDestTxBufferRef = /EAS/PduR/PduRRoutingTables/PduRTxBufferTable/PduRTxBuffer/
          CanConfigSet_Tx_CAN_Network_BMS_CellVoltData16: UserDefine=false
            Src_CanConfigSet_Tx_CAN_Network_BMS_CellVoltData16 (PduRSrcPdu): PduRSourcePduHandleId=50, PduRSrcModule=COM, PduRSrcPduUpTxConf=true, UserDefine=false, PduRSrcPduRef=CanConfigSet_Tx_CAN_Network_BMS_CellVoltData16
            Dest_CanConfigSet_Tx_CAN_Network_BMS_CellVoltData16 (PduRDestPdu):
              PduRDestPduDataProvision = PDUR_DIRECT
              PduRDestPduHandleId = 0
              PduRTpThreshold = 7
              PduRTransmissionConfirmation = true
              PduRDestModule = CANIF
              UserDefine = false
              PduRDestPduRef = CanConfigSet_Tx_CAN_Network_BMS_CellVoltData16
              PduRDestTxBufferRef = /EAS/PduR/PduRRoutingTables/PduRTxBufferTable/PduRTxBuffer/
          CanConfigSet_Tx_CAN_Network_BMS_CellVoltData15: UserDefine=false
            Src_CanConfigSet_Tx_CAN_Network_BMS_CellVoltData15 (PduRSrcPdu): PduRSourcePduHandleId=51, PduRSrcModule=COM, PduRSrcPduUpTxConf=true, UserDefine=false, PduRSrcPduRef=CanConfigSet_Tx_CAN_Network_BMS_CellVoltData15
            Dest_CanConfigSet_Tx_CAN_Network_BMS_CellVoltData15 (PduRDestPdu):
              PduRDestPduDataProvision = PDUR_DIRECT
              PduRDestPduHandleId = 0
              PduRTpThreshold = 7
              PduRTransmissionConfirmation = true
              PduRDestModule = CANIF
              UserDefine = false
              PduRDestPduRef = CanConfigSet_Tx_CAN_Network_BMS_CellVoltData15
              PduRDestTxBufferRef = /EAS/PduR/PduRRoutingTables/PduRTxBufferTable/PduRTxBuffer/
          CanConfigSet_Tx_CAN_Network_BMS_CellVoltData14: UserDefine=false
            Src_CanConfigSet_Tx_CAN_Network_BMS_CellVoltData14 (PduRSrcPdu): PduRSourcePduHandleId=52, PduRSrcModule=COM, PduRSrcPduUpTxConf=true, UserDefine=false, PduRSrcPduRef=CanConfigSet_Tx_CAN_Network_BMS_CellVoltData14
            Dest_CanConfigSet_Tx_CAN_Network_BMS_CellVoltData14 (PduRDestPdu):
              PduRDestPduDataProvision = PDUR_DIRECT
              PduRDestPduHandleId = 0
              PduRTpThreshold = 7
              PduRTransmissionConfirmation = true
              PduRDestModule = CANIF
              UserDefine = false
              PduRDestPduRef = CanConfigSet_Tx_CAN_Network_BMS_CellVoltData14
              PduRDestTxBufferRef = /EAS/PduR/PduRRoutingTables/PduRTxBufferTable/PduRTxBuffer/
          CanConfigSet_Tx_CAN_Network_BMS_CellVoltData13: UserDefine=false
            Src_CanConfigSet_Tx_CAN_Network_BMS_CellVoltData13 (PduRSrcPdu): PduRSourcePduHandleId=53, PduRSrcModule=COM, PduRSrcPduUpTxConf=true, UserDefine=false, PduRSrcPduRef=CanConfigSet_Tx_CAN_Network_BMS_CellVoltData13
            Dest_CanConfigSet_Tx_CAN_Network_BMS_CellVoltData13 (PduRDestPdu):
              PduRDestPduDataProvision = PDUR_DIRECT
              PduRDestPduHandleId = 0
              PduRTpThreshold = 7
              PduRTransmissionConfirmation = true
              PduRDestModule = CANIF
              UserDefine = false
              PduRDestPduRef = CanConfigSet_Tx_CAN_Network_BMS_CellVoltData13
              PduRDestTxBufferRef = /EAS/PduR/PduRRoutingTables/PduRTxBufferTable/PduRTxBuffer/
          CanConfigSet_Tx_CAN_Network_BMS_CellVoltData12: UserDefine=false
            Src_CanConfigSet_Tx_CAN_Network_BMS_CellVoltData12 (PduRSrcPdu): PduRSourcePduHandleId=54, PduRSrcModule=COM, PduRSrcPduUpTxConf=true, UserDefine=false, PduRSrcPduRef=CanConfigSet_Tx_CAN_Network_BMS_CellVoltData12
            Dest_CanConfigSet_Tx_CAN_Network_BMS_CellVoltData12 (PduRDestPdu):
              PduRDestPduDataProvision = PDUR_DIRECT
              PduRDestPduHandleId = 0
              PduRTpThreshold = 7
              PduRTransmissionConfirmation = true
              PduRDestModule = CANIF
              UserDefine = false
              PduRDestPduRef = CanConfigSet_Tx_CAN_Network_BMS_CellVoltData12
              PduRDestTxBufferRef = /EAS/PduR/PduRRoutingTables/PduRTxBufferTable/PduRTxBuffer/
          CanConfigSet_Tx_CAN_Network_BMS_CellVoltData11: UserDefine=false
            Src_CanConfigSet_Tx_CAN_Network_BMS_CellVoltData11 (PduRSrcPdu): PduRSourcePduHandleId=55, PduRSrcModule=COM, PduRSrcPduUpTxConf=true, UserDefine=false, PduRSrcPduRef=CanConfigSet_Tx_CAN_Network_BMS_CellVoltData11
            Dest_CanConfigSet_Tx_CAN_Network_BMS_CellVoltData11 (PduRDestPdu):
              PduRDestPduDataProvision = PDUR_DIRECT
              PduRDestPduHandleId = 0
              PduRTpThreshold = 7
              PduRTransmissionConfirmation = true
              PduRDestModule = CANIF
              UserDefine = false
              PduRDestPduRef = CanConfigSet_Tx_CAN_Network_BMS_CellVoltData11
              PduRDestTxBufferRef = /EAS/PduR/PduRRoutingTables/PduRTxBufferTable/PduRTxBuffer/
          CanConfigSet_Tx_CAN_Network_BMS_CellVoltData10: UserDefine=false
            Src_CanConfigSet_Tx_CAN_Network_BMS_CellVoltData10 (PduRSrcPdu): PduRSourcePduHandleId=56, PduRSrcModule=COM, PduRSrcPduUpTxConf=true, UserDefine=false, PduRSrcPduRef=CanConfigSet_Tx_CAN_Network_BMS_CellVoltData10
            Dest_CanConfigSet_Tx_CAN_Network_BMS_CellVoltData10 (PduRDestPdu):
              PduRDestPduDataProvision = PDUR_DIRECT
              PduRDestPduHandleId = 0
              PduRTpThreshold = 7
              PduRTransmissionConfirmation = true
              PduRDestModule = CANIF
              UserDefine = false
              PduRDestPduRef = CanConfigSet_Tx_CAN_Network_BMS_CellVoltData10
              PduRDestTxBufferRef = /EAS/PduR/PduRRoutingTables/PduRTxBufferTable/PduRTxBuffer/
          CanConfigSet_Tx_CAN_Network_BMS_CellVoltData9: UserDefine=false
            Src_CanConfigSet_Tx_CAN_Network_BMS_CellVoltData9 (PduRSrcPdu): PduRSourcePduHandleId=57, PduRSrcModule=COM, PduRSrcPduUpTxConf=true, UserDefine=false, PduRSrcPduRef=CanConfigSet_Tx_CAN_Network_BMS_CellVoltData9
            Dest_CanConfigSet_Tx_CAN_Network_BMS_CellVoltData9 (PduRDestPdu):
              PduRDestPduDataProvision = PDUR_DIRECT
              PduRDestPduHandleId = 0
              PduRTpThreshold = 7
              PduRTransmissionConfirmation = true
              PduRDestModule = CANIF
              UserDefine = false
              PduRDestPduRef = CanConfigSet_Tx_CAN_Network_BMS_CellVoltData9
              PduRDestTxBufferRef = /EAS/PduR/PduRRoutingTables/PduRTxBufferTable/PduRTxBuffer/
          CanConfigSet_Tx_CAN_Network_BMS_CellVoltData8: UserDefine=false
            Src_CanConfigSet_Tx_CAN_Network_BMS_CellVoltData8 (PduRSrcPdu): PduRSourcePduHandleId=58, PduRSrcModule=COM, PduRSrcPduUpTxConf=true, UserDefine=false, PduRSrcPduRef=CanConfigSet_Tx_CAN_Network_BMS_CellVoltData8
            Dest_CanConfigSet_Tx_CAN_Network_BMS_CellVoltData8 (PduRDestPdu):
              PduRDestPduDataProvision = PDUR_DIRECT
              PduRDestPduHandleId = 0
              PduRTpThreshold = 7
              PduRTransmissionConfirmation = true
              PduRDestModule = CANIF
              UserDefine = false
              PduRDestPduRef = CanConfigSet_Tx_CAN_Network_BMS_CellVoltData8
              PduRDestTxBufferRef = /EAS/PduR/PduRRoutingTables/PduRTxBufferTable/PduRTxBuffer/
          CanConfigSet_Tx_CAN_Network_BMS_CellVoltData7: UserDefine=false
            Src_CanConfigSet_Tx_CAN_Network_BMS_CellVoltData7 (PduRSrcPdu): PduRSourcePduHandleId=59, PduRSrcModule=COM, PduRSrcPduUpTxConf=true, UserDefine=false, PduRSrcPduRef=CanConfigSet_Tx_CAN_Network_BMS_CellVoltData7
            Dest_CanConfigSet_Tx_CAN_Network_BMS_CellVoltData7 (PduRDestPdu):
              PduRDestPduDataProvision = PDUR_DIRECT
              PduRDestPduHandleId = 0
              PduRTpThreshold = 7
              PduRTransmissionConfirmation = true
              PduRDestModule = CANIF
              UserDefine = false
              PduRDestPduRef = CanConfigSet_Tx_CAN_Network_BMS_CellVoltData7
              PduRDestTxBufferRef = /EAS/PduR/PduRRoutingTables/PduRTxBufferTable/PduRTxBuffer/
          CanConfigSet_Tx_CAN_Network_BMS_CellVoltData6: UserDefine=false
            Src_CanConfigSet_Tx_CAN_Network_BMS_CellVoltData6 (PduRSrcPdu): PduRSourcePduHandleId=60, PduRSrcModule=COM, PduRSrcPduUpTxConf=true, UserDefine=false, PduRSrcPduRef=CanConfigSet_Tx_CAN_Network_BMS_CellVoltData6
            Dest_CanConfigSet_Tx_CAN_Network_BMS_CellVoltData6 (PduRDestPdu):
              PduRDestPduDataProvision = PDUR_DIRECT
              PduRDestPduHandleId = 0
              PduRTpThreshold = 7
              PduRTransmissionConfirmation = true
              PduRDestModule = CANIF
              UserDefine = false
              PduRDestPduRef = CanConfigSet_Tx_CAN_Network_BMS_CellVoltData6
              PduRDestTxBufferRef = /EAS/PduR/PduRRoutingTables/PduRTxBufferTable/PduRTxBuffer/
          CanConfigSet_Tx_CAN_Network_BMS_CellVoltData5: UserDefine=false
            Src_CanConfigSet_Tx_CAN_Network_BMS_CellVoltData5 (PduRSrcPdu): PduRSourcePduHandleId=61, PduRSrcModule=COM, PduRSrcPduUpTxConf=true, UserDefine=false, PduRSrcPduRef=CanConfigSet_Tx_CAN_Network_BMS_CellVoltData5
            Dest_CanConfigSet_Tx_CAN_Network_BMS_CellVoltData5 (PduRDestPdu):
              PduRDestPduDataProvision = PDUR_DIRECT
              PduRDestPduHandleId = 0
              PduRTpThreshold = 7
              PduRTransmissionConfirmation = true
              PduRDestModule = CANIF
              UserDefine = false
              PduRDestPduRef = CanConfigSet_Tx_CAN_Network_BMS_CellVoltData5
              PduRDestTxBufferRef = /EAS/PduR/PduRRoutingTables/PduRTxBufferTable/PduRTxBuffer/
          CanConfigSet_Tx_CAN_Network_BMS_CellVoltData4: UserDefine=false
            Src_CanConfigSet_Tx_CAN_Network_BMS_CellVoltData4 (PduRSrcPdu): PduRSourcePduHandleId=62, PduRSrcModule=COM, PduRSrcPduUpTxConf=true, UserDefine=false, PduRSrcPduRef=CanConfigSet_Tx_CAN_Network_BMS_CellVoltData4
            Dest_CanConfigSet_Tx_CAN_Network_BMS_CellVoltData4 (PduRDestPdu):
              PduRDestPduDataProvision = PDUR_DIRECT
              PduRDestPduHandleId = 0
              PduRTpThreshold = 7
              PduRTransmissionConfirmation = true
              PduRDestModule = CANIF
              UserDefine = false
              PduRDestPduRef = CanConfigSet_Tx_CAN_Network_BMS_CellVoltData4
              PduRDestTxBufferRef = /EAS/PduR/PduRRoutingTables/PduRTxBufferTable/PduRTxBuffer/
          CanConfigSet_Tx_CAN_Network_BMS_CellVoltData3: UserDefine=false
            Src_CanConfigSet_Tx_CAN_Network_BMS_CellVoltData3 (PduRSrcPdu): PduRSourcePduHandleId=63, PduRSrcModule=COM, PduRSrcPduUpTxConf=true, UserDefine=false, PduRSrcPduRef=CanConfigSet_Tx_CAN_Network_BMS_CellVoltData3
            Dest_CanConfigSet_Tx_CAN_Network_BMS_CellVoltData3 (PduRDestPdu):
              PduRDestPduDataProvision = PDUR_DIRECT
              PduRDestPduHandleId = 0
              PduRTpThreshold = 7
              PduRTransmissionConfirmation = true
              PduRDestModule = CANIF
              UserDefine = false
              PduRDestPduRef = CanConfigSet_Tx_CAN_Network_BMS_CellVoltData3
              PduRDestTxBufferRef = /EAS/PduR/PduRRoutingTables/PduRTxBufferTable/PduRTxBuffer/
          CanConfigSet_Tx_CAN_Network_BMS_CellVoltData2: UserDefine=false
            Src_CanConfigSet_Tx_CAN_Network_BMS_CellVoltData2 (PduRSrcPdu): PduRSourcePduHandleId=64, PduRSrcModule=COM, PduRSrcPduUpTxConf=true, UserDefine=false, PduRSrcPduRef=CanConfigSet_Tx_CAN_Network_BMS_CellVoltData2
            Dest_CanConfigSet_Tx_CAN_Network_BMS_CellVoltData2 (PduRDestPdu):
              PduRDestPduDataProvision = PDUR_DIRECT
              PduRDestPduHandleId = 0
              PduRTpThreshold = 7
              PduRTransmissionConfirmation = true
              PduRDestModule = CANIF
              UserDefine = false
              PduRDestPduRef = CanConfigSet_Tx_CAN_Network_BMS_CellVoltData2
              PduRDestTxBufferRef = /EAS/PduR/PduRRoutingTables/PduRTxBufferTable/PduRTxBuffer/
          CanConfigSet_Tx_CAN_Network_BMS_CellTempData2: UserDefine=false
            Src_CanConfigSet_Tx_CAN_Network_BMS_CellTempData2 (PduRSrcPdu): PduRSourcePduHandleId=65, PduRSrcModule=COM, PduRSrcPduUpTxConf=true, UserDefine=false, PduRSrcPduRef=CanConfigSet_Tx_CAN_Network_BMS_CellTempData2
            Dest_CanConfigSet_Tx_CAN_Network_BMS_CellTempData2 (PduRDestPdu):
              PduRDestPduDataProvision = PDUR_DIRECT
              PduRDestPduHandleId = 0
              PduRTpThreshold = 7
              PduRTransmissionConfirmation = true
              PduRDestModule = CANIF
              UserDefine = false
              PduRDestPduRef = CanConfigSet_Tx_CAN_Network_BMS_CellTempData2
              PduRDestTxBufferRef = /EAS/PduR/PduRRoutingTables/PduRTxBufferTable/PduRTxBuffer/
          CanConfigSet_Tx_CAN_Network_BMS_RelayInfo: UserDefine=false
            Src_CanConfigSet_Tx_CAN_Network_BMS_RelayInfo (PduRSrcPdu): PduRSourcePduHandleId=66, PduRSrcModule=COM, PduRSrcPduUpTxConf=true, UserDefine=false, PduRSrcPduRef=CanConfigSet_Tx_CAN_Network_BMS_RelayInfo
            Dest_CanConfigSet_Tx_CAN_Network_BMS_RelayInfo (PduRDestPdu):
              PduRDestPduDataProvision = PDUR_DIRECT
              PduRDestPduHandleId = 0
              PduRTpThreshold = 7
              PduRTransmissionConfirmation = true
              PduRDestModule = CANIF
              UserDefine = false
              PduRDestPduRef = CanConfigSet_Tx_CAN_Network_BMS_RelayInfo
              PduRDestTxBufferRef = /EAS/PduR/PduRRoutingTables/PduRTxBufferTable/PduRTxBuffer/
          CanConfigSet_Tx_CAN_Network_BMS_ChgInfo: UserDefine=false
            Src_CanConfigSet_Tx_CAN_Network_BMS_ChgInfo (PduRSrcPdu): PduRSourcePduHandleId=67, PduRSrcModule=COM, PduRSrcPduUpTxConf=true, UserDefine=false, PduRSrcPduRef=CanConfigSet_Tx_CAN_Network_BMS_ChgInfo
            Dest_CanConfigSet_Tx_CAN_Network_BMS_ChgInfo (PduRDestPdu):
              PduRDestPduDataProvision = PDUR_DIRECT
              PduRDestPduHandleId = 0
              PduRTpThreshold = 7
              PduRTransmissionConfirmation = true
              PduRDestModule = CANIF
              UserDefine = false
              PduRDestPduRef = CanConfigSet_Tx_CAN_Network_BMS_ChgInfo
              PduRDestTxBufferRef = /EAS/PduR/PduRRoutingTables/PduRTxBufferTable/PduRTxBuffer/
          CanConfigSet_Tx_CAN_Network_BMS_BatteryInfo: UserDefine=false
            Src_CanConfigSet_Tx_CAN_Network_BMS_BatteryInfo (PduRSrcPdu): PduRSourcePduHandleId=68, PduRSrcModule=COM, PduRSrcPduUpTxConf=true, UserDefine=false, PduRSrcPduRef=CanConfigSet_Tx_CAN_Network_BMS_BatteryInfo
            Dest_CanConfigSet_Tx_CAN_Network_BMS_BatteryInfo (PduRDestPdu):
              PduRDestPduDataProvision = PDUR_DIRECT
              PduRDestPduHandleId = 0
              PduRTpThreshold = 7
              PduRTransmissionConfirmation = true
              PduRDestModule = CANIF
              UserDefine = false
              PduRDestPduRef = CanConfigSet_Tx_CAN_Network_BMS_BatteryInfo
              PduRDestTxBufferRef = /EAS/PduR/PduRRoutingTables/PduRTxBufferTable/PduRTxBuffer/
          CanConfigSet_Tx_CAN_Network_BMS_HVIsolationInfo: UserDefine=false
            Src_CanConfigSet_Tx_CAN_Network_BMS_HVIsolationInfo (PduRSrcPdu):
              PduRSourcePduHandleId = 69
              PduRSrcModule = COM
              PduRSrcPduUpTxConf = true
              UserDefine = false
              PduRSrcPduRef = CanConfigSet_Tx_CAN_Network_BMS_HVIsolationInfo
            Dest_CanConfigSet_Tx_CAN_Network_BMS_HVIsolationInfo (PduRDestPdu):
              PduRDestPduDataProvision = PDUR_DIRECT
              PduRDestPduHandleId = 0
              PduRTpThreshold = 7
              PduRTransmissionConfirmation = true
              PduRDestModule = CANIF
              UserDefine = false
              PduRDestPduRef = CanConfigSet_Tx_CAN_Network_BMS_HVIsolationInfo
              PduRDestTxBufferRef = /EAS/PduR/PduRRoutingTables/PduRTxBufferTable/PduRTxBuffer/
          CanConfigSet_Tx_CAN_Network_BMS_BattaryFltInfo: UserDefine=false
            Src_CanConfigSet_Tx_CAN_Network_BMS_BattaryFltInfo (PduRSrcPdu): PduRSourcePduHandleId=70, PduRSrcModule=COM, PduRSrcPduUpTxConf=true, UserDefine=false, PduRSrcPduRef=CanConfigSet_Tx_CAN_Network_BMS_BattaryFltInfo
            Dest_CanConfigSet_Tx_CAN_Network_BMS_BattaryFltInfo (PduRDestPdu):
              PduRDestPduDataProvision = PDUR_DIRECT
              PduRDestPduHandleId = 0
              PduRTpThreshold = 7
              PduRTransmissionConfirmation = true
              PduRDestModule = CANIF
              UserDefine = false
              PduRDestPduRef = CanConfigSet_Tx_CAN_Network_BMS_BattaryFltInfo
              PduRDestTxBufferRef = /EAS/PduR/PduRRoutingTables/PduRTxBufferTable/PduRTxBuffer/
          CanConfigSet_Tx_CAN_Network_BMS_BatPackLmt: UserDefine=false
            Src_CanConfigSet_Tx_CAN_Network_BMS_BatPackLmt (PduRSrcPdu): PduRSourcePduHandleId=71, PduRSrcModule=COM, PduRSrcPduUpTxConf=true, UserDefine=false, PduRSrcPduRef=CanConfigSet_Tx_CAN_Network_BMS_BatPackLmt
            Dest_CanConfigSet_Tx_CAN_Network_BMS_BatPackLmt (PduRDestPdu):
              PduRDestPduDataProvision = PDUR_DIRECT
              PduRDestPduHandleId = 0
              PduRTpThreshold = 7
              PduRTransmissionConfirmation = true
              PduRDestModule = CANIF
              UserDefine = false
              PduRDestPduRef = CanConfigSet_Tx_CAN_Network_BMS_BatPackLmt
              PduRDestTxBufferRef = /EAS/PduR/PduRRoutingTables/PduRTxBufferTable/PduRTxBuffer/
          CanConfigSet_Tx_CAN_Network_BMS_PACKInfo1: UserDefine=false
            Src_CanConfigSet_Tx_CAN_Network_BMS_PACKInfo1 (PduRSrcPdu): PduRSourcePduHandleId=72, PduRSrcModule=COM, PduRSrcPduUpTxConf=true, UserDefine=false, PduRSrcPduRef=CanConfigSet_Tx_CAN_Network_BMS_PACKInfo1
            Dest_CanConfigSet_Tx_CAN_Network_BMS_PACKInfo1 (PduRDestPdu):
              PduRDestPduDataProvision = PDUR_DIRECT
              PduRDestPduHandleId = 0
              PduRTpThreshold = 7
              PduRTransmissionConfirmation = true
              PduRDestModule = CANIF
              UserDefine = false
              PduRDestPduRef = CanConfigSet_Tx_CAN_Network_BMS_PACKInfo1
              PduRDestTxBufferRef = /EAS/PduR/PduRRoutingTables/PduRTxBufferTable/PduRTxBuffer/
          CanConfigSet_Tx_CAN_Network_BMS_PACKManfInfo1: UserDefine=false
            Src_CanConfigSet_Tx_CAN_Network_BMS_PACKManfInfo1 (PduRSrcPdu): PduRSourcePduHandleId=73, PduRSrcModule=COM, PduRSrcPduUpTxConf=true, UserDefine=false, PduRSrcPduRef=CanConfigSet_Tx_CAN_Network_BMS_PACKManfInfo1
            Dest_CanConfigSet_Tx_CAN_Network_BMS_PACKManfInfo1 (PduRDestPdu):
              PduRDestPduDataProvision = PDUR_DIRECT
              PduRDestPduHandleId = 0
              PduRTpThreshold = 7
              PduRTransmissionConfirmation = true
              PduRDestModule = CANIF
              UserDefine = false
              PduRDestPduRef = CanConfigSet_Tx_CAN_Network_BMS_PACKManfInfo1
              PduRDestTxBufferRef = /EAS/PduR/PduRRoutingTables/PduRTxBufferTable/PduRTxBuffer/
          CanConfigSet_Tx_CAN_Network_BMS_PACKManfInfo2: UserDefine=false
            Src_CanConfigSet_Tx_CAN_Network_BMS_PACKManfInfo2 (PduRSrcPdu): PduRSourcePduHandleId=74, PduRSrcModule=COM, PduRSrcPduUpTxConf=true, UserDefine=false, PduRSrcPduRef=CanConfigSet_Tx_CAN_Network_BMS_PACKManfInfo2
            Dest_CanConfigSet_Tx_CAN_Network_BMS_PACKManfInfo2 (PduRDestPdu):
              PduRDestPduDataProvision = PDUR_DIRECT
              PduRDestPduHandleId = 0
              PduRTpThreshold = 7
              PduRTransmissionConfirmation = true
              PduRDestModule = CANIF
              UserDefine = false
              PduRDestPduRef = CanConfigSet_Tx_CAN_Network_BMS_PACKManfInfo2
              PduRDestTxBufferRef = /EAS/PduR/PduRRoutingTables/PduRTxBufferTable/PduRTxBuffer/
          CanConfigSet_Tx_CAN_Network_BMS_Min_MAX_CellTemp: UserDefine=false
            Src_CanConfigSet_Tx_CAN_Network_BMS_Min_MAX_CellTemp (PduRSrcPdu):
              PduRSourcePduHandleId = 75
              PduRSrcModule = COM
              PduRSrcPduUpTxConf = true
              UserDefine = false
              PduRSrcPduRef = CanConfigSet_Tx_CAN_Network_BMS_Min_MAX_CellTemp
            Dest_CanConfigSet_Tx_CAN_Network_BMS_Min_MAX_CellTemp (PduRDestPdu):
              PduRDestPduDataProvision = PDUR_DIRECT
              PduRDestPduHandleId = 0
              PduRTpThreshold = 7
              PduRTransmissionConfirmation = true
              PduRDestModule = CANIF
              UserDefine = false
              PduRDestPduRef = CanConfigSet_Tx_CAN_Network_BMS_Min_MAX_CellTemp
              PduRDestTxBufferRef = /EAS/PduR/PduRRoutingTables/PduRTxBufferTable/PduRTxBuffer/
          CanConfigSet_Tx_CAN_Network_BMS_Min_MAX_CellVolt: UserDefine=false
            Src_CanConfigSet_Tx_CAN_Network_BMS_Min_MAX_CellVolt (PduRSrcPdu):
              PduRSourcePduHandleId = 76
              PduRSrcModule = COM
              PduRSrcPduUpTxConf = true
              UserDefine = false
              PduRSrcPduRef = CanConfigSet_Tx_CAN_Network_BMS_Min_MAX_CellVolt
            Dest_CanConfigSet_Tx_CAN_Network_BMS_Min_MAX_CellVolt (PduRDestPdu):
              PduRDestPduDataProvision = PDUR_DIRECT
              PduRDestPduHandleId = 0
              PduRTpThreshold = 7
              PduRTransmissionConfirmation = true
              PduRDestModule = CANIF
              UserDefine = false
              PduRDestPduRef = CanConfigSet_Tx_CAN_Network_BMS_Min_MAX_CellVolt
              PduRDestTxBufferRef = /EAS/PduR/PduRRoutingTables/PduRTxBufferTable/PduRTxBuffer/
          CanConfigSet_Tx_CAN_Network_BMS_CellVoltData1: UserDefine=false
            Src_CanConfigSet_Tx_CAN_Network_BMS_CellVoltData1 (PduRSrcPdu): PduRSourcePduHandleId=77, PduRSrcModule=COM, PduRSrcPduUpTxConf=true, UserDefine=false, PduRSrcPduRef=CanConfigSet_Tx_CAN_Network_BMS_CellVoltData1
            Dest_CanConfigSet_Tx_CAN_Network_BMS_CellVoltData1 (PduRDestPdu):
              PduRDestPduDataProvision = PDUR_DIRECT
              PduRDestPduHandleId = 0
              PduRTpThreshold = 7
              PduRTransmissionConfirmation = true
              PduRDestModule = CANIF
              UserDefine = false
              PduRDestPduRef = CanConfigSet_Tx_CAN_Network_BMS_CellVoltData1
              PduRDestTxBufferRef = /EAS/PduR/PduRRoutingTables/PduRTxBufferTable/PduRTxBuffer/
          CanConfigSet_Tx_CAN_Network_BMS_CellTempData1: UserDefine=false
            Src_CanConfigSet_Tx_CAN_Network_BMS_CellTempData1 (PduRSrcPdu): PduRSourcePduHandleId=78, PduRSrcModule=COM, PduRSrcPduUpTxConf=true, UserDefine=false, PduRSrcPduRef=CanConfigSet_Tx_CAN_Network_BMS_CellTempData1
            Dest_CanConfigSet_Tx_CAN_Network_BMS_CellTempData1 (PduRDestPdu):
              PduRDestPduDataProvision = PDUR_DIRECT
              PduRDestPduHandleId = 0
              PduRTpThreshold = 7
              PduRTransmissionConfirmation = true
              PduRDestModule = CANIF
              UserDefine = false
              PduRDestPduRef = CanConfigSet_Tx_CAN_Network_BMS_CellTempData1
              PduRDestTxBufferRef = /EAS/PduR/PduRRoutingTables/PduRTxBufferTable/PduRTxBuffer/
          CanConfigSet_Tx_CAN_Network_BMS_BattEnyInfo: UserDefine=false
            Src_CanConfigSet_Tx_CAN_Network_BMS_BattEnyInfo (PduRSrcPdu): PduRSourcePduHandleId=79, PduRSrcModule=COM, PduRSrcPduUpTxConf=true, UserDefine=false, PduRSrcPduRef=CanConfigSet_Tx_CAN_Network_BMS_BattEnyInfo
            Dest_CanConfigSet_Tx_CAN_Network_BMS_BattEnyInfo (PduRDestPdu):
              PduRDestPduDataProvision = PDUR_DIRECT
              PduRDestPduHandleId = 0
              PduRTpThreshold = 7
              PduRTransmissionConfirmation = true
              PduRDestModule = CANIF
              UserDefine = false
              PduRDestPduRef = CanConfigSet_Tx_CAN_Network_BMS_BattEnyInfo
              PduRDestTxBufferRef = /EAS/PduR/PduRRoutingTables/PduRTxBufferTable/PduRTxBuffer/
          CanConfigSet_Tx_CAN_Network_BMS_ChgTempInfo: UserDefine=false
            Src_CanConfigSet_Tx_CAN_Network_BMS_ChgTempInfo (PduRSrcPdu): PduRSourcePduHandleId=80, PduRSrcModule=COM, PduRSrcPduUpTxConf=true, UserDefine=false, PduRSrcPduRef=CanConfigSet_Tx_CAN_Network_BMS_ChgTempInfo
            Dest_CanConfigSet_Tx_CAN_Network_BMS_ChgTempInfo (PduRDestPdu):
              PduRDestPduDataProvision = PDUR_DIRECT
              PduRDestPduHandleId = 0
              PduRTpThreshold = 7
              PduRTransmissionConfirmation = true
              PduRDestModule = CANIF
              UserDefine = false
              PduRDestPduRef = CanConfigSet_Tx_CAN_Network_BMS_ChgTempInfo
              PduRDestTxBufferRef = /EAS/PduR/PduRRoutingTables/PduRTxBufferTable/PduRTxBuffer/
          CanConfigSet_Tx_CAN_Network_BMS_ThermalMangeInfor: UserDefine=false
            Src_CanConfigSet_Tx_CAN_Network_BMS_ThermalMangeInfor (PduRSrcPdu):
              PduRSourcePduHandleId = 81
              PduRSrcModule = COM
              PduRSrcPduUpTxConf = true
              UserDefine = false
              PduRSrcPduRef = CanConfigSet_Tx_CAN_Network_BMS_ThermalMangeInfor
            Dest_CanConfigSet_Tx_CAN_Network_BMS_ThermalMangeInfor (PduRDestPdu):
              PduRDestPduDataProvision = PDUR_DIRECT
              PduRDestPduHandleId = 0
              PduRTpThreshold = 7
              PduRTransmissionConfirmation = true
              PduRDestModule = CANIF
              UserDefine = false
              PduRDestPduRef = CanConfigSet_Tx_CAN_Network_BMS_ThermalMangeInfor
              PduRDestTxBufferRef = /EAS/PduR/PduRRoutingTables/PduRTxBufferTable/PduRTxBuffer/
          CanConfigSet_Tx_CAN_Network_BMS_FastChgStopInfo: UserDefine=false
            Src_CanConfigSet_Tx_CAN_Network_BMS_FastChgStopInfo (PduRSrcPdu):
              PduRSourcePduHandleId = 82
              PduRSrcModule = COM
              PduRSrcPduUpTxConf = true
              UserDefine = false
              PduRSrcPduRef = CanConfigSet_Tx_CAN_Network_BMS_FastChgStopInfo
            Dest_CanConfigSet_Tx_CAN_Network_BMS_FastChgStopInfo (PduRDestPdu):
              PduRDestPduDataProvision = PDUR_DIRECT
              PduRDestPduHandleId = 0
              PduRTpThreshold = 7
              PduRTransmissionConfirmation = true
              PduRDestModule = CANIF
              UserDefine = false
              PduRDestPduRef = CanConfigSet_Tx_CAN_Network_BMS_FastChgStopInfo
              PduRDestTxBufferRef = /EAS/PduR/PduRRoutingTables/PduRTxBufferTable/PduRTxBuffer/
          CanConfigSet_Tx_CAN_Network_BMS_TestInfo1: UserDefine=false
            Src_CanConfigSet_Tx_CAN_Network_BMS_TestInfo1 (PduRSrcPdu): PduRSourcePduHandleId=83, PduRSrcModule=COM, PduRSrcPduUpTxConf=true, UserDefine=false, PduRSrcPduRef=CanConfigSet_Tx_CAN_Network_BMS_TestInfo1
            Dest_CanConfigSet_Tx_CAN_Network_BMS_TestInfo1 (PduRDestPdu):
              PduRDestPduDataProvision = PDUR_DIRECT
              PduRDestPduHandleId = 0
              PduRTpThreshold = 7
              PduRTransmissionConfirmation = true
              PduRDestModule = CANIF
              UserDefine = false
              PduRDestPduRef = CanConfigSet_Tx_CAN_Network_BMS_TestInfo1
              PduRDestTxBufferRef = /EAS/PduR/PduRRoutingTables/PduRTxBufferTable/PduRTxBuffer/
          CanConfigSet_Tx_CAN_Network_BMS_BattEnyInfo1: UserDefine=false
            Src_CanConfigSet_Tx_CAN_Network_BMS_BattEnyInfo1 (PduRSrcPdu): PduRSourcePduHandleId=84, PduRSrcModule=COM, PduRSrcPduUpTxConf=true, UserDefine=false, PduRSrcPduRef=CanConfigSet_Tx_CAN_Network_BMS_BattEnyInfo1
            Dest_CanConfigSet_Tx_CAN_Network_BMS_BattEnyInfo1 (PduRDestPdu):
              PduRDestPduDataProvision = PDUR_DIRECT
              PduRDestPduHandleId = 0
              PduRTpThreshold = 7
              PduRTransmissionConfirmation = true
              PduRDestModule = CANIF
              UserDefine = false
              PduRDestPduRef = CanConfigSet_Tx_CAN_Network_BMS_BattEnyInfo1
              PduRDestTxBufferRef = /EAS/PduR/PduRRoutingTables/PduRTxBufferTable/PduRTxBuffer/
          CanConfigSet_Tx_CAN_Network_BMS_VerInfo: UserDefine=false
            Src_CanConfigSet_Tx_CAN_Network_BMS_VerInfo (PduRSrcPdu): PduRSourcePduHandleId=85, PduRSrcModule=COM, PduRSrcPduUpTxConf=true, UserDefine=false, PduRSrcPduRef=CanConfigSet_Tx_CAN_Network_BMS_VerInfo
            Dest_CanConfigSet_Tx_CAN_Network_BMS_VerInfo (PduRDestPdu):
              PduRDestPduDataProvision = PDUR_DIRECT
              PduRDestPduHandleId = 0
              PduRTpThreshold = 7
              PduRTransmissionConfirmation = true
              PduRDestModule = CANIF
              UserDefine = false
              PduRDestPduRef = CanConfigSet_Tx_CAN_Network_BMS_VerInfo
              PduRDestTxBufferRef = /EAS/PduR/PduRRoutingTables/PduRTxBufferTable/PduRTxBuffer/
          CanConfigSet_Tx_Jigao_BMS_GBT_BRM: UserDefine=false
            Src_CanConfigSet_Tx_Jigao_BMS_GBT_BRM (PduRSrcPdu): PduRSourcePduHandleId=86, PduRSrcModule=COM, PduRSrcPduUpTxConf=true, UserDefine=false, PduRSrcPduRef=CanConfigSet_Tx_Jigao_BMS_GBT_BRM
            Dest_CanConfigSet_Tx_Jigao_BMS_GBT_BRM (PduRDestPdu):
              PduRDestPduDataProvision = PDUR_DIRECT
              PduRDestPduHandleId = 0
              PduRTpThreshold = 7
              PduRTransmissionConfirmation = true
              PduRDestModule = J1939TP
              UserDefine = false
              PduRDestPduRef = CanConfigSet_Tx_Jigao_BMS_GBT_BRM
              PduRDestTxBufferRef = /EAS/PduR/PduRRoutingTables/PduRTxBufferTable/PduRTxBuffer/
          CanConfigSet_Tx_Jigao_BMS_GBT_BCP: UserDefine=false
            Src_CanConfigSet_Tx_Jigao_BMS_GBT_BCP (PduRSrcPdu): PduRSourcePduHandleId=87, PduRSrcModule=COM, PduRSrcPduUpTxConf=true, UserDefine=false, PduRSrcPduRef=CanConfigSet_Tx_Jigao_BMS_GBT_BCP
            Dest_CanConfigSet_Tx_Jigao_BMS_GBT_BCP (PduRDestPdu):
              PduRDestPduDataProvision = PDUR_DIRECT
              PduRDestPduHandleId = 0
              PduRTpThreshold = 7
              PduRTransmissionConfirmation = true
              PduRDestModule = J1939TP
              UserDefine = false
              PduRDestPduRef = CanConfigSet_Tx_Jigao_BMS_GBT_BCP
              PduRDestTxBufferRef = /EAS/PduR/PduRRoutingTables/PduRTxBufferTable/PduRTxBuffer/
          CanConfigSet_Tx_Jigao_BMS_GBT_BCS: UserDefine=false
            Src_CanConfigSet_Tx_Jigao_BMS_GBT_BCS (PduRSrcPdu): PduRSourcePduHandleId=88, PduRSrcModule=COM, PduRSrcPduUpTxConf=true, UserDefine=false, PduRSrcPduRef=CanConfigSet_Tx_Jigao_BMS_GBT_BCS
            Dest_CanConfigSet_Tx_Jigao_BMS_GBT_BCS (PduRDestPdu):
              PduRDestPduDataProvision = PDUR_DIRECT
              PduRDestPduHandleId = 0
              PduRTpThreshold = 7
              PduRTransmissionConfirmation = true
              PduRDestModule = J1939TP
              UserDefine = false
              PduRDestPduRef = CanConfigSet_Tx_Jigao_BMS_GBT_BCS
              PduRDestTxBufferRef = /EAS/PduR/PduRRoutingTables/PduRTxBufferTable/PduRTxBuffer/
          CanConfigSet_Tx_Jigao_BMS_GBT_BMV: UserDefine=false
            Src_CanConfigSet_Tx_Jigao_BMS_GBT_BMV (PduRSrcPdu): PduRSourcePduHandleId=89, PduRSrcModule=COM, PduRSrcPduUpTxConf=true, UserDefine=false, PduRSrcPduRef=CanConfigSet_Tx_Jigao_BMS_GBT_BMV
            Dest_CanConfigSet_Tx_Jigao_BMS_GBT_BMV (PduRDestPdu):
              PduRDestPduDataProvision = PDUR_DIRECT
              PduRDestPduHandleId = 0
              PduRTpThreshold = 7
              PduRTransmissionConfirmation = true
              PduRDestModule = J1939TP
              UserDefine = false
              PduRDestPduRef = CanConfigSet_Tx_Jigao_BMS_GBT_BMV
              PduRDestTxBufferRef = /EAS/PduR/PduRRoutingTables/PduRTxBufferTable/PduRTxBuffer/
          CanConfigSet_Tx_Jigao_BMS_GBT_BMT: UserDefine=false
            Src_CanConfigSet_Tx_Jigao_BMS_GBT_BMT (PduRSrcPdu): PduRSourcePduHandleId=90, PduRSrcModule=COM, PduRSrcPduUpTxConf=true, UserDefine=false, PduRSrcPduRef=CanConfigSet_Tx_Jigao_BMS_GBT_BMT
            Dest_CanConfigSet_Tx_Jigao_BMS_GBT_BMT (PduRDestPdu):
              PduRDestPduDataProvision = PDUR_DIRECT
              PduRDestPduHandleId = 0
              PduRTpThreshold = 7
              PduRTransmissionConfirmation = true
              PduRDestModule = J1939TP
              UserDefine = false
              PduRDestPduRef = CanConfigSet_Tx_Jigao_BMS_GBT_BMT
              PduRDestTxBufferRef = /EAS/PduR/PduRRoutingTables/PduRTxBufferTable/PduRTxBuffer/
          CanConfigSet_Tx_Jigao_BMS_GBT_BSP: UserDefine=false
            Src_CanConfigSet_Tx_Jigao_BMS_GBT_BSP (PduRSrcPdu): PduRSourcePduHandleId=91, PduRSrcModule=COM, PduRSrcPduUpTxConf=true, UserDefine=false, PduRSrcPduRef=CanConfigSet_Tx_Jigao_BMS_GBT_BSP
            Dest_CanConfigSet_Tx_Jigao_BMS_GBT_BSP (PduRDestPdu):
              PduRDestPduDataProvision = PDUR_DIRECT
              PduRDestPduHandleId = 0
              PduRTpThreshold = 7
              PduRTransmissionConfirmation = true
              PduRDestModule = J1939TP
              UserDefine = false
              PduRDestPduRef = CanConfigSet_Tx_Jigao_BMS_GBT_BSP
              PduRDestTxBufferRef = /EAS/PduR/PduRRoutingTables/PduRTxBufferTable/PduRTxBuffer/
          CanConfigSet_Tx_Jigao_BMS_GBT_BEM: UserDefine=false
            Src_CanConfigSet_Tx_Jigao_BMS_GBT_BEM (PduRSrcPdu): PduRSourcePduHandleId=92, PduRSrcModule=COM, PduRSrcPduUpTxConf=true, UserDefine=false, PduRSrcPduRef=CanConfigSet_Tx_Jigao_BMS_GBT_BEM
            Dest_CanConfigSet_Tx_Jigao_BMS_GBT_BEM (PduRDestPdu):
              PduRDestPduDataProvision = PDUR_DIRECT
              PduRDestPduHandleId = 0
              PduRTpThreshold = 7
              PduRTransmissionConfirmation = true
              PduRDestModule = CANIF
              UserDefine = false
              PduRDestPduRef = CanConfigSet_Tx_Jigao_BMS_GBT_BEM
              PduRDestTxBufferRef = /EAS/PduR/PduRRoutingTables/PduRTxBufferTable/PduRTxBuffer/
          CanConfigSet_Tx_Jigao_BMS_GBT_BRO: UserDefine=false
            Src_CanConfigSet_Tx_Jigao_BMS_GBT_BRO (PduRSrcPdu): PduRSourcePduHandleId=93, PduRSrcModule=COM, PduRSrcPduUpTxConf=true, UserDefine=false, PduRSrcPduRef=CanConfigSet_Tx_Jigao_BMS_GBT_BRO
            Dest_CanConfigSet_Tx_Jigao_BMS_GBT_BRO (PduRDestPdu):
              PduRDestPduDataProvision = PDUR_DIRECT
              PduRDestPduHandleId = 0
              PduRTpThreshold = 7
              PduRTransmissionConfirmation = true
              PduRDestModule = CANIF
              UserDefine = false
              PduRDestPduRef = CanConfigSet_Tx_Jigao_BMS_GBT_BRO
              PduRDestTxBufferRef = /EAS/PduR/PduRRoutingTables/PduRTxBufferTable/PduRTxBuffer/
          CanConfigSet_Tx_Jigao_BMS_GBT_BST: UserDefine=false
            Src_CanConfigSet_Tx_Jigao_BMS_GBT_BST (PduRSrcPdu): PduRSourcePduHandleId=94, PduRSrcModule=COM, PduRSrcPduUpTxConf=true, UserDefine=false, PduRSrcPduRef=CanConfigSet_Tx_Jigao_BMS_GBT_BST
            Dest_CanConfigSet_Tx_Jigao_BMS_GBT_BST (PduRDestPdu):
              PduRDestPduDataProvision = PDUR_DIRECT
              PduRDestPduHandleId = 0
              PduRTpThreshold = 7
              PduRTransmissionConfirmation = true
              PduRDestModule = CANIF
              UserDefine = false
              PduRDestPduRef = CanConfigSet_Tx_Jigao_BMS_GBT_BST
              PduRDestTxBufferRef = /EAS/PduR/PduRRoutingTables/PduRTxBufferTable/PduRTxBuffer/
          CanConfigSet_Tx_Jigao_BMS_GBT_BCL: UserDefine=false
            Src_CanConfigSet_Tx_Jigao_BMS_GBT_BCL (PduRSrcPdu): PduRSourcePduHandleId=95, PduRSrcModule=COM, PduRSrcPduUpTxConf=true, UserDefine=false, PduRSrcPduRef=CanConfigSet_Tx_Jigao_BMS_GBT_BCL
            Dest_CanConfigSet_Tx_Jigao_BMS_GBT_BCL (PduRDestPdu):
              PduRDestPduDataProvision = PDUR_DIRECT
              PduRDestPduHandleId = 0
              PduRTpThreshold = 7
              PduRTransmissionConfirmation = true
              PduRDestModule = CANIF
              UserDefine = false
              PduRDestPduRef = CanConfigSet_Tx_Jigao_BMS_GBT_BCL
              PduRDestTxBufferRef = /EAS/PduR/PduRRoutingTables/PduRTxBufferTable/PduRTxBuffer/
          CanConfigSet_Tx_Jigao_BMS_GBT_BSM: UserDefine=false
            Src_CanConfigSet_Tx_Jigao_BMS_GBT_BSM (PduRSrcPdu): PduRSourcePduHandleId=96, PduRSrcModule=COM, PduRSrcPduUpTxConf=true, UserDefine=false, PduRSrcPduRef=CanConfigSet_Tx_Jigao_BMS_GBT_BSM
            Dest_CanConfigSet_Tx_Jigao_BMS_GBT_BSM (PduRDestPdu):
              PduRDestPduDataProvision = PDUR_DIRECT
              PduRDestPduHandleId = 0
              PduRTpThreshold = 7
              PduRTransmissionConfirmation = true
              PduRDestModule = CANIF
              UserDefine = false
              PduRDestPduRef = CanConfigSet_Tx_Jigao_BMS_GBT_BSM
              PduRDestTxBufferRef = /EAS/PduR/PduRRoutingTables/PduRTxBufferTable/PduRTxBuffer/
          CanConfigSet_Tx_Jigao_BMS_GBT_BSD: UserDefine=false
            Src_CanConfigSet_Tx_Jigao_BMS_GBT_BSD (PduRSrcPdu): PduRSourcePduHandleId=97, PduRSrcModule=COM, PduRSrcPduUpTxConf=true, UserDefine=false, PduRSrcPduRef=CanConfigSet_Tx_Jigao_BMS_GBT_BSD
            Dest_CanConfigSet_Tx_Jigao_BMS_GBT_BSD (PduRDestPdu):
              PduRDestPduDataProvision = PDUR_DIRECT
              PduRDestPduHandleId = 0
              PduRTpThreshold = 7
              PduRTransmissionConfirmation = true
              PduRDestModule = CANIF
              UserDefine = false
              PduRDestPduRef = CanConfigSet_Tx_Jigao_BMS_GBT_BSD
              PduRDestTxBufferRef = /EAS/PduR/PduRRoutingTables/PduRTxBufferTable/PduRTxBuffer/
          CanConfigSet_Tx_Jigao_BMS_GBT_BHM: UserDefine=false
            Src_CanConfigSet_Tx_Jigao_BMS_GBT_BHM (PduRSrcPdu): PduRSourcePduHandleId=98, PduRSrcModule=COM, PduRSrcPduUpTxConf=true, UserDefine=false, PduRSrcPduRef=CanConfigSet_Tx_Jigao_BMS_GBT_BHM
            Dest_CanConfigSet_Tx_Jigao_BMS_GBT_BHM (PduRDestPdu):
              PduRDestPduDataProvision = PDUR_DIRECT
              PduRDestPduHandleId = 0
              PduRTpThreshold = 7
              PduRTransmissionConfirmation = true
              PduRDestModule = CANIF
              UserDefine = false
              PduRDestPduRef = CanConfigSet_Tx_Jigao_BMS_GBT_BHM
              PduRDestTxBufferRef = /EAS/PduR/PduRRoutingTables/PduRTxBufferTable/PduRTxBuffer/
          CanConfigSet_Tx_Jigao_BMS_GBT_BCPP: UserDefine=false
            Src_CanConfigSet_Tx_Jigao_BMS_GBT_BCPP (PduRSrcPdu): PduRSourcePduHandleId=99, PduRSrcModule=COM, PduRSrcPduUpTxConf=true, UserDefine=false, PduRSrcPduRef=CanConfigSet_Tx_Jigao_BMS_GBT_BCPP
            Dest_CanConfigSet_Tx_Jigao_BMS_GBT_BCPP (PduRDestPdu):
              PduRDestPduDataProvision = PDUR_DIRECT
              PduRDestPduHandleId = 0
              PduRTpThreshold = 7
              PduRTransmissionConfirmation = true
              PduRDestModule = CANIF
              UserDefine = false
              PduRDestPduRef = CanConfigSet_Tx_Jigao_BMS_GBT_BCPP
              PduRDestTxBufferRef = /EAS/PduR/PduRRoutingTables/PduRTxBufferTable/PduRTxBuffer/
          CanConfigSet_Tx_Jigao_BMS_GBT_BCSP: UserDefine=false
            Src_CanConfigSet_Tx_Jigao_BMS_GBT_BCSP (PduRSrcPdu): PduRSourcePduHandleId=100, PduRSrcModule=COM, PduRSrcPduUpTxConf=true, UserDefine=false, PduRSrcPduRef=CanConfigSet_Tx_Jigao_BMS_GBT_BCSP
            Dest_CanConfigSet_Tx_Jigao_BMS_GBT_BCSP (PduRDestPdu):
              PduRDestPduDataProvision = PDUR_DIRECT
              PduRDestPduHandleId = 0
              PduRTpThreshold = 7
              PduRTransmissionConfirmation = true
              PduRDestModule = CANIF
              UserDefine = false
              PduRDestPduRef = CanConfigSet_Tx_Jigao_BMS_GBT_BCSP
              PduRDestTxBufferRef = /EAS/PduR/PduRRoutingTables/PduRTxBufferTable/PduRTxBuffer/
          CanConfigSet_Tx_Jigao_BMS_GBT_BDC: UserDefine=false
            Src_CanConfigSet_Tx_Jigao_BMS_GBT_BDC (PduRSrcPdu): PduRSourcePduHandleId=101, PduRSrcModule=COM, PduRSrcPduUpTxConf=true, UserDefine=false, PduRSrcPduRef=CanConfigSet_Tx_Jigao_BMS_GBT_BDC
            Dest_CanConfigSet_Tx_Jigao_BMS_GBT_BDC (PduRDestPdu):
              PduRDestPduDataProvision = PDUR_DIRECT
              PduRDestPduHandleId = 0
              PduRTpThreshold = 7
              PduRTransmissionConfirmation = true
              PduRDestModule = J1939TP
              UserDefine = false
              PduRDestPduRef = CanConfigSet_Tx_Jigao_BMS_GBT_BDC
              PduRDestTxBufferRef = /EAS/PduR/PduRRoutingTables/PduRTxBufferTable/PduRTxBuffer/
          CanConfigSet_Tx_CAN_Network_BMS_CellVoltData26: UserDefine=false
            Src_CanConfigSet_Tx_CAN_Network_BMS_CellVoltData26 (PduRSrcPdu):
              PduRSourcePduHandleId = 102
              PduRSrcModule = COM
              PduRSrcPduUpTxConf = true
              UserDefine = false
              PduRSrcPduRef = CanConfigSet_Tx_CAN_Network_BMS_CellVoltData26
            Dest_CanConfigSet_Tx_CAN_Network_BMS_CellVoltData26 (PduRDestPdu):
              PduRDestPduDataProvision = PDUR_DIRECT
              PduRDestPduHandleId = 0
              PduRTpThreshold = 7
              PduRTransmissionConfirmation = true
              PduRDestModule = CANIF
              UserDefine = false
              PduRDestPduRef = CanConfigSet_Tx_CAN_Network_BMS_CellVoltData26
              PduRDestTxBufferRef = /EAS/PduR/PduRRoutingTables/PduRTxBufferTable/PduRTxBuffer/
          CanConfigSet_Tx_CAN_Network_BMS_SysCode: UserDefine=false
            Src_CanConfigSet_Tx_CAN_Network_BMS_SysCode (PduRSrcPdu): PduRSourcePduHandleId=103, PduRSrcModule=COM, PduRSrcPduUpTxConf=true, UserDefine=false, PduRSrcPduRef=CanConfigSet_Tx_CAN_Network_BMS_SysCode
            Dest_CanConfigSet_Tx_CAN_Network_BMS_SysCode (PduRDestPdu):
              PduRDestPduDataProvision = PDUR_DIRECT
              PduRDestPduHandleId = 0
              PduRTpThreshold = 7
              PduRTransmissionConfirmation = true
              PduRDestModule = CANIF
              UserDefine = false
              PduRDestPduRef = CanConfigSet_Tx_CAN_Network_BMS_SysCode
              PduRDestTxBufferRef = /EAS/PduR/PduRRoutingTables/PduRTxBufferTable/PduRTxBuffer/
          CanConfigSet_Tx_CAN_Network_BMS_CellVoltData25: UserDefine=false
            Src_CanConfigSet_Tx_CAN_Network_BMS_CellVoltData25 (PduRSrcPdu):
              PduRSourcePduHandleId = 104
              PduRSrcModule = COM
              PduRSrcPduUpTxConf = true
              UserDefine = false
              PduRSrcPduRef = CanConfigSet_Tx_CAN_Network_BMS_CellVoltData25
            Dest_CanConfigSet_Tx_CAN_Network_BMS_CellVoltData25 (PduRDestPdu):
              PduRDestPduDataProvision = PDUR_DIRECT
              PduRDestPduHandleId = 0
              PduRTpThreshold = 7
              PduRTransmissionConfirmation = true
              PduRDestModule = CANIF
              UserDefine = false
              PduRDestPduRef = CanConfigSet_Tx_CAN_Network_BMS_CellVoltData25
              PduRDestTxBufferRef = /EAS/PduR/PduRRoutingTables/PduRTxBufferTable/PduRTxBuffer/
          CanConfigSet_Tx_CAN_Network_BMS_CellTempData3: UserDefine=false
            Src_CanConfigSet_Tx_CAN_Network_BMS_CellTempData3 (PduRSrcPdu): PduRSourcePduHandleId=105, PduRSrcModule=COM, PduRSrcPduUpTxConf=true, UserDefine=false, PduRSrcPduRef=CanConfigSet_Tx_CAN_Network_BMS_CellTempData3
            Dest_CanConfigSet_Tx_CAN_Network_BMS_CellTempData3 (PduRDestPdu):
              PduRDestPduDataProvision = PDUR_DIRECT
              PduRDestPduHandleId = 0
              PduRTpThreshold = 7
              PduRTransmissionConfirmation = true
              PduRDestModule = CANIF
              UserDefine = false
              PduRDestPduRef = CanConfigSet_Tx_CAN_Network_BMS_CellTempData3
              PduRDestTxBufferRef = /EAS/PduR/PduRRoutingTables/PduRTxBufferTable/PduRTxBuffer/
          CanConfigSet_Tx_CAN_Network_BMS_BatterySwap: UserDefine=false
            Src_CanConfigSet_Tx_CAN_Network_BMS_BatterySwap (PduRSrcPdu): PduRSourcePduHandleId=106, PduRSrcModule=COM, PduRSrcPduUpTxConf=true, UserDefine=false, PduRSrcPduRef=CanConfigSet_Tx_CAN_Network_BMS_BatterySwap
            Dest_CanConfigSet_Tx_CAN_Network_BMS_BatterySwap (PduRDestPdu):
              PduRDestPduDataProvision = PDUR_DIRECT
              PduRDestPduHandleId = 0
              PduRTpThreshold = 7
              PduRTransmissionConfirmation = true
              PduRDestModule = CANIF
              UserDefine = false
              PduRDestPduRef = CanConfigSet_Tx_CAN_Network_BMS_BatterySwap
              PduRDestTxBufferRef = /EAS/PduR/PduRRoutingTables/PduRTxBufferTable/PduRTxBuffer/
          CanConfigSet_Tx_CAN_Network_BMS_EnyInfo: UserDefine=false
            Src_CanConfigSet_Tx_CAN_Network_BMS_EnyInfo (PduRSrcPdu): PduRSourcePduHandleId=107, PduRSrcModule=COM, PduRSrcPduUpTxConf=true, UserDefine=false, PduRSrcPduRef=CanConfigSet_Tx_CAN_Network_BMS_EnyInfo
            Dest_CanConfigSet_Tx_CAN_Network_BMS_EnyInfo (PduRDestPdu):
              PduRDestPduDataProvision = PDUR_DIRECT
              PduRDestPduHandleId = 0
              PduRTpThreshold = 7
              PduRTransmissionConfirmation = true
              PduRDestModule = CANIF
              UserDefine = false
              PduRDestPduRef = CanConfigSet_Tx_CAN_Network_BMS_EnyInfo
              PduRDestTxBufferRef = /EAS/PduR/PduRRoutingTables/PduRTxBufferTable/PduRTxBuffer/
          CanConfigSet_Rx_CAN_Network_BMS_DiagReq: UserDefine=false
            Src_CanConfigSet_Rx_CAN_Network_BMS_DiagReq (PduRSrcPdu): PduRSourcePduHandleId=108, PduRSrcModule=CANTP, PduRSrcPduUpTxConf=true, UserDefine=false, PduRSrcPduRef=CanConfigSet_Rx_CAN_Network_BMS_DiagReq
            Dest_CanConfigSet_Rx_CAN_Network_BMS_DiagReq (PduRDestPdu):
              PduRDestPduDataProvision = PDUR_DIRECT
              PduRDestPduHandleId = 0
              PduRTpThreshold = 7
              PduRTransmissionConfirmation = true
              PduRDestModule = DCM
              UserDefine = false
              PduRDestPduRef = CanConfigSet_Rx_CAN_Network_BMS_DiagReq
              PduRDestTxBufferRef = /EAS/PduR/PduRRoutingTables/PduRTxBufferTable/PduRTxBuffer/
          CanConfigSet_Rx_CAN_Network_Func_DiagReq: UserDefine=false
            Src_CanConfigSet_Rx_CAN_Network_Func_DiagReq (PduRSrcPdu): PduRSourcePduHandleId=109, PduRSrcModule=CANTP, PduRSrcPduUpTxConf=true, UserDefine=false, PduRSrcPduRef=CanConfigSet_Rx_CAN_Network_Func_DiagReq
            Dest_CanConfigSet_Rx_CAN_Network_Func_DiagReq (PduRDestPdu):
              PduRDestPduDataProvision = PDUR_DIRECT
              PduRDestPduHandleId = 0
              PduRTpThreshold = 7
              PduRTransmissionConfirmation = true
              PduRDestModule = DCM
              UserDefine = false
              PduRDestPduRef = CanConfigSet_Rx_CAN_Network_Func_DiagReq
              PduRDestTxBufferRef = /EAS/PduR/PduRRoutingTables/PduRTxBufferTable/PduRTxBuffer/
          CanConfigSet_Tx_CAN_Network_BMS_DiagResp: UserDefine=false
            Src_CanConfigSet_Tx_CAN_Network_BMS_DiagResp (PduRSrcPdu): PduRSourcePduHandleId=110, PduRSrcModule=DCM, PduRSrcPduUpTxConf=true, UserDefine=false, PduRSrcPduRef=CanConfigSet_Tx_CAN_Network_BMS_DiagResp
            Dest_CanConfigSet_Tx_CAN_Network_BMS_DiagResp (PduRDestPdu):
              PduRDestPduDataProvision = PDUR_DIRECT
              PduRDestPduHandleId = 0
              PduRTpThreshold = 7
              PduRTransmissionConfirmation = true
              PduRDestModule = CANTP
              UserDefine = false
              PduRDestPduRef = CanConfigSet_Tx_CAN_Network_BMS_DiagResp
              PduRDestTxBufferRef = /EAS/PduR/PduRRoutingTables/PduRTxBufferTable/PduRTxBuffer/
          CanConfigSet_Rx_CAN_Network_PMS_VIN: UserDefine=false
            Src_CanConfigSet_Rx_CAN_Network_PMS_VIN (PduRSrcPdu): PduRSourcePduHandleId=111, PduRSrcModule=J1939TP, PduRSrcPduUpTxConf=true, UserDefine=false, PduRSrcPduRef=CanConfigSet_Rx_CAN_Network_PMS_VIN
            Dest_CanConfigSet_Rx_CAN_Network_PMS_VIN (PduRDestPdu):
              PduRDestPduDataProvision = PDUR_DIRECT
              PduRDestPduHandleId = 0
              PduRTpThreshold = 7
              PduRTransmissionConfirmation = true
              PduRDestModule = COM
              UserDefine = false
              PduRDestPduRef = CanConfigSet_Rx_CAN_Network_PMS_VIN
              PduRDestTxBufferRef = /EAS/PduR/PduRRoutingTables/PduRTxBufferTable/PduRTxBuffer/
      PduRTxBufferTable: PduRMaxTxBufferNumber=0
    5 x PduRBswModules, all with PduRCancelReceive=false, PduRCancelTransmit=false, PduRChangeParameterApi=false, PduRTxConfirmation=true:
      CanIf: PduRCommunicationInterface=true, PduRLowerModule=true, PduRRetransmission=false, PduRTransportProtocol=false, PduRTriggertransmit=false, PduRUpperModule=false, PduRUseTag=false, PduRBswModuleRef=CanIf
      CanTp: PduRCommunicationInterface=false, PduRLowerModule=true, PduRRetransmission=true, PduRTransportProtocol=true, PduRTriggertransmit=false, PduRUpperModule=false, PduRUseTag=false, PduRBswModuleRef=CanTp
      Com: PduRCommunicationInterface=true, PduRLowerModule=false, PduRRetransmission=false, PduRTransportProtocol=true, PduRTriggertransmit=true, PduRUpperModule=true, PduRUseTag=true, PduRBswModuleRef=Com
      Dcm: PduRCommunicationInterface=false, PduRLowerModule=false, PduRRetransmission=false, PduRTransportProtocol=true, PduRTriggertransmit=true, PduRUpperModule=true, PduRUseTag=true, PduRBswModuleRef=Dcm
      J1939Tp: PduRCommunicationInterface=false, PduRLowerModule=true, PduRRetransmission=true, PduRTransportProtocol=true, PduRTriggertransmit=false, PduRUpperModule=false, PduRUseTag=false, PduRBswModuleRef=J1939Tp
