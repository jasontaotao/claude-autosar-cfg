AUTOSAR XML (schema 4-2-2)
package /EAS
  elements service-needs={needed-hardware-variant=VARIANT-PRE-COMPILE, needed-trigger-mode=EXTERNAL-TRIGGER}, eas-custom-data={runtime-mode=SUPERVISOR, callback=DetCallback}:
    exclusive area DetExclusiveArea0
    module config Det
      DetGeneral: DetDebugLoop=false
