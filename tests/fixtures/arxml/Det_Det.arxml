AUTOSAR XML (schema 4-2-2)
package /EcucDefs
  ecuc definition collection AUTOSARParameterDefinition: module=Det
  module config Det: implementation-config-variant=STD_CONFIG_VARIANTS_PRECOMPILE, module_version_def=1.2.3, module_autosar_version=Ar422
    DetGeneral:
      DetDebugLoop = false
      DetForwardToDlt = false
      VersionCheck = true
      DetVersionApi = false
      DetErrorHook = 
      CddHeaderFile = 
      DetReportRuntimeErrorCallout = 
      DetReportTransientFaultCallout = 
