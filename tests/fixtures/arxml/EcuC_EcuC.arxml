AUTOSAR XML (schema 4-2-2)
package /EcucDefs
  ecuc definition collection AUTOSARParameterDefinition: module=EcuC
  module config EcuC: implementation-config-variant=STD_CONFIG_VARIANTS_PRECOMPILE, module_version_def=1.1.12, module_autosar_version=Ar422
    EcucGeneral: BitOrder=LSB, ByteOrder=Intel, CPUType=CPU32Bit
    EcucVariationResolver
    EcucPduCollection: PduIdTypeEnum=uint8, PduLengthTypeEnum=uint16
      125 x Pdu, all with SysTPduToFrameMappingRef=PDU-TO-FRAME-MAPPING/:
        CanConfigSet_Tx_CAN_Network_BMS_DiagResp: PduLength=8, UserDefine=false, PduType=DBC
        CanConfigSet_Tx_CAN_Network_BMS_CellVoltData24: PduLength=8, UserDefine=false, PduType=DBC
        CanConfigSet_Tx_CAN_Network_BMS_CellVoltData23: PduLength=8, UserDefine=false, PduType=DBC
        CanConfigSet_Tx_CAN_Network_BMS_CellVoltData22: PduLength=8, UserDefine=false, PduType=DBC
        CanConfigSet_Tx_CAN_Network_BMS_CellVoltData21: PduLength=8, UserDefine=false, PduType=DBC
        CanConfigSet_Tx_CAN_Network_BMS_CellVoltData20: PduLength=8, UserDefine=false, PduType=DBC
        CanConfigSet_Tx_CAN_Network_BMS_CellVoltData19: PduLength=8, UserDefine=false, PduType=DBC
        CanConfigSet_Tx_CAN_Network_BMS_CellVoltData18: PduLength=8, UserDefine=false, PduType=DBC
        CanConfigSet_Tx_CAN_Network_BMS_CellVoltData17: PduLength=8, UserDefine=false, PduType=DBC
        CanConfigSet_Tx_CAN_Network_BMS_CellVoltData16: PduLength=8, UserDefine=false, PduType=DBC
        CanConfigSet_Tx_CAN_Network_BMS_CellVoltData15: PduLength=8, UserDefine=false, PduType=DBC
        CanConfigSet_Tx_CAN_Network_BMS_CellVoltData14: PduLength=8, UserDefine=false, PduType=DBC
        CanConfigSet_Tx_CAN_Network_BMS_CellVoltData13: PduLength=8, UserDefine=false, PduType=DBC
        CanConfigSet_Tx_CAN_Network_BMS_CellVoltData12: PduLength=8, UserDefine=false, PduType=DBC
        CanConfigSet_Tx_CAN_Network_BMS_CellVoltData11: PduLength=8, UserDefine=false, PduType=DBC
        CanConfigSet_Tx_CAN_Network_BMS_CellVoltData10: PduLength=8, UserDefine=false, PduType=DBC
        CanConfigSet_Tx_CAN_Network_BMS_CellVoltData9: PduLength=8, UserDefine=false, PduType=DBC
        CanConfigSet_Tx_CAN_Network_BMS_CellVoltData8: PduLength=8, UserDefine=false, PduType=DBC
        CanConfigSet_Tx_CAN_Network_BMS_CellVoltData7: PduLength=8, UserDefine=false, PduType=DBC
        CanConfigSet_Tx_CAN_Network_BMS_CellVoltData6: PduLength=8, UserDefine=false, PduType=DBC
        CanConfigSet_Tx_CAN_Network_BMS_CellVoltData5: PduLength=8, UserDefine=false, PduType=DBC
        CanConfigSet_Tx_CAN_Network_BMS_CellVoltData4: PduLength=8, UserDefine=false, PduType=DBC
        CanConfigSet_Tx_CAN_Network_BMS_CellVoltData3: PduLength=8, UserDefine=false, PduType=DBC
        CanConfigSet_Tx_CAN_Network_BMS_CellVoltData2: PduLength=8, UserDefine=false, PduType=DBC
        CanConfigSet_Tx_CAN_Network_BMS_CellTempData2: PduLength=8, UserDefine=false, PduType=DBC
        CanConfigSet_Tx_CAN_Network_BMS_RelayInfo: PduLength=8, UserDefine=false, PduType=DBC
        CanConfigSet_Tx_CAN_Network_BMS_ChgInfo: PduLength=8, UserDefine=false, PduType=DBC
        CanConfigSet_Tx_CAN_Network_BMS_BatteryInfo: PduLength=8, UserDefine=false, PduType=DBC
        CanConfigSet_Tx_CAN_Network_BMS_HVIsolationInfo: PduLength=8, UserDefine=false, PduType=DBC
        CanConfigSet_Tx_CAN_Network_BMS_BattaryFltInfo: PduLength=8, UserDefine=false, PduType=DBC
        CanConfigSet_Tx_CAN_Network_BMS_BatPackLmt: PduLength=8, UserDefine=false, PduType=DBC
        CanConfigSet_Tx_CAN_Network_BMS_PACKInfo1: PduLength=8, UserDefine=false, PduType=DBC
        CanConfigSet_Tx_CAN_Network_BMS_PACKManfInfo1: PduLength=8, UserDefine=false, PduType=DBC
        CanConfigSet_Tx_CAN_Network_BMS_PACKManfInfo2: PduLength=8, UserDefine=false, PduType=DBC
        CanConfigSet_Tx_CAN_Network_BMS_Min_MAX_CellTemp: PduLength=8, UserDefine=false, PduType=DBC
        CanConfigSet_Tx_CAN_Network_BMS_Min_MAX_CellVolt: PduLength=8, UserDefine=false, PduType=DBC
        CanConfigSet_Tx_CAN_Network_BMS_CellVoltData1: PduLength=8, UserDefine=false, PduType=DBC
        CanConfigSet_Tx_CAN_Network_BMS_CellTempData1: PduLength=8, UserDefine=false, PduType=DBC
        CanConfigSet_Tx_CAN_Network_BMS_BattEnyInfo: PduLength=8, UserDefine=false, PduType=DBC
        CanConfigSet_Tx_CAN_Network_BMS_ChgTempInfo: PduLength=8, UserDefine=false, PduType=DBC
        CanConfigSet_Tx_CAN_Network_BMS_ThermalMangeInfor: PduLength=8, UserDefine=false, PduType=DBC
        CanConfigSet_Tx_CAN_Network_BMS_FastChgStopInfo: PduLength=8, UserDefine=false, PduType=DBC
        CanConfigSet_Tx_CAN_Network_BMS_TestInfo1: PduLength=8, UserDefine=false, PduType=DBC
        CanConfigSet_Tx_CAN_Network_BMS_BattEnyInfo1: PduLength=8, UserDefine=false, PduType=DBC
        CanConfigSet_Tx_CAN_Network_BMS_VerInfo: PduLength=8, UserDefine=false, PduType=DBC
        CanConfigSet_Tx_CAN_Network_XcpResp: PduLength=8, UserDefine=false, PduType=DBC
        CanConfigSet_Tx_CAN_Network_BMS_NWM: PduLength=8, UserDefine=false, PduType=DBC
        CanConfigSet_Rx_CAN_Network_MCU_MotorSts: PduLength=8, UserDefine=false, PduType=DBC
        CanConfigSet_Rx_CAN_Network_BMS_DiagReq: PduLength=8, UserDefine=false, PduType=DBC
        CanConfigSet_Rx_CAN_Network_Func_DiagReq: PduLength=8, UserDefine=false, PduType=DBC
        CanConfigSet_Rx_CAN_Network_OBC_GeneralSts: PduLength=8, UserDefine=false, PduType=DBC
        CanConfigSet_Rx_CAN_Network_OBC_ChgParameter: PduLength=8, UserDefine=false, PduType=DBC
        CanConfigSet_Rx_CAN_Network_DCDC_StatusInfo: PduLength=8, UserDefine=false, PduType=DBC
        CanConfigSet_Rx_CAN_Network_TBOX_TD: PduLength=8, UserDefine=false, PduType=DBC
        CanConfigSet_Rx_CAN_Network_XcpReq: PduLength=8, UserDefine=false, PduType=DBC
        CanConfigSet_Tx_Jigao_BMS_GBT_BEM: PduLength=4, UserDefine=false, PduType=DBC
        CanConfigSet_Tx_Jigao_BMS_GBT_BRO: PduLength=1, UserDefine=false, PduType=DBC
        CanConfigSet_Tx_Jigao_BMS_GBT_BST: PduLength=4, UserDefine=false, PduType=DBC
        CanConfigSet_Tx_Jigao_BMS_GBT_BCL: PduLength=5, UserDefine=false, PduType=DBC
        CanConfigSet_Tx_Jigao_BMS_GBT_BSM: PduLength=7, UserDefine=false, PduType=DBC
        CanConfigSet_Tx_Jigao_BMS_GBT_BSD: PduLength=7, UserDefine=false, PduType=DBC
        CanConfigSet_Tx_Jigao_BMS_GBT_BHM: PduLength=2, UserDefine=false, PduType=DBC
        CanConfigSet_Tx_Jigao_BMS_GBT_BRM: PduLength=49, UserDefine=false, PduType=DBC
        CanConfigSet_Tx_Jigao_BMS_GBT_BCP: PduLength=13, UserDefine=false, PduType=DBC
        CanConfigSet_Tx_Jigao_BMS_GBT_BCS: PduLength=9, UserDefine=false, PduType=DBC
        CanConfigSet_Tx_Jigao_BMS_GBT_BMV: PduLength=204, UserDefine=false, PduType=DBC
        CanConfigSet_Tx_Jigao_BMS_GBT_BMT: PduLength=18, UserDefine=false, PduType=DBC
        CanConfigSet_Tx_Jigao_BMS_GBT_BSP: PduLength=16, UserDefine=false, PduType=DBC
        CanConfigSet_Tx_Jigao_BMS_GBT_J1939Pdu_0x1ceb56f4: PduLength=8, UserDefine=false, PduType=DBC
        CanConfigSet_Tx_Jigao_BMS_GBT_J1939Pdu_0x1cec56f4: PduLength=8, UserDefine=false, PduType=DBC
        CanConfigSet_Rx_Jigao_BMS_GBT_CEM: PduLength=4, UserDefine=false, PduType=DBC
        CanConfigSet_Rx_Jigao_BMS_GBT_CRO: PduLength=1, UserDefine=false, PduType=DBC
        CanConfigSet_Rx_Jigao_BMS_GBT_CST: PduLength=4, UserDefine=false, PduType=DBC
        CanConfigSet_Rx_Jigao_BMS_GBT_CRM: PduLength=8, UserDefine=false, PduType=DBC
        CanConfigSet_Rx_Jigao_BMS_GBT_CTS: PduLength=7, UserDefine=false, PduType=DBC
        CanConfigSet_Rx_Jigao_BMS_GBT_CML: PduLength=8, UserDefine=false, PduType=DBC
        CanConfigSet_Rx_Jigao_BMS_GBT_CCS: PduLength=8, UserDefine=false, PduType=DBC
        CanConfigSet_Rx_Jigao_BMS_GBT_CSD: PduLength=8, UserDefine=false, PduType=DBC
        CanConfigSet_Rx_Jigao_BMS_GBT_CHM: PduLength=3, UserDefine=false, PduType=DBC
        CanConfigSet_Rx_Jigao_BMS_GBT_J1939Pdu_0x1cecf456: PduLength=8, UserDefine=false, PduType=DBC
        CanConfigSet_Rx_CAN_Network_PMS_HVFunctionCtrl: PduLength=8, UserDefine=false, PduType=DBC
        CanConfigSet_Rx_CAN_Network_PMS_BodyControlInfo: PduLength=8, UserDefine=false, PduType=DBC
        CanConfigSet_Rx_CAN_Network_PMS_PTInfoIndicate: PduLength=8, UserDefine=false, PduType=DBC
        CanConfigSet_Rx_CAN_Network_PMS_VIN: PduLength=17, UserDefine=false, PduType=DBC
        CanConfigSet_Tx_Jigao_BMS_GBT_BCPP: PduLength=7, UserDefine=false, PduType=DBC
        CanConfigSet_Tx_Jigao_BMS_GBT_BDC: PduLength=28, UserDefine=false, PduType=DBC
        CanConfigSet_Tx_Jigao_BMS_GBT_BCSP: PduLength=8, UserDefine=false, PduType=DBC
        CanConfigSet_Tx_Jigao_BMS_GBT_J1939Pdu_0x18eb56f4: PduLength=8, UserDefine=false, PduType=DBC
        CanConfigSet_Tx_Jigao_BMS_GBT_J1939Pdu_0x18ec56f4: PduLength=8, UserDefine=false, PduType=DBC
        CanConfigSet_Rx_Jigao_BMS_GBT_CDC: PduLength=3, UserDefine=false, PduType=DBC
        CanConfigSet_Rx_Jigao_BMS_GBT_CMLP: PduLength=8, UserDefine=false, PduType=DBC
        CanConfigSet_Rx_Jigao_BMS_GBT_CCD: PduLength=3, UserDefine=false, PduType=DBC
        CanConfigSet_Rx_Jigao_BMS_GBT_CSDP: PduLength=8, UserDefine=false, PduType=DBC
        CanConfigSet_Rx_Jigao_BMS_GBT_J1939Pdu_0x18ecf456: PduLength=8, UserDefine=false, PduType=DBC
        CanConfigSet_Tx_CAN_Network_BMS_CellVoltData26: PduLength=8, UserDefine=false, PduType=DBC
        CanConfigSet_Tx_CAN_Network_BMS_SysCode: PduLength=8, UserDefine=false, PduType=DBC
        CanConfigSet_Tx_CAN_Network_BMS_CellVoltData25: PduLength=8, UserDefine=false, PduType=DBC
        CanConfigSet_Tx_CAN_Network_BMS_CellTempData3: PduLength=8, UserDefine=false, PduType=DBC
        CanConfigSet_Tx_CAN_Network_BMS_BatterySwap: PduLength=8, UserDefine=false, PduType=DBC
        CanConfigSet_Rx_CAN_Network_HCM_WorkInfo: PduLength=8, UserDefine=false, PduType=DBC
        CanConfigSet_Rx_CAN_Network_HCM_Status: PduLength=8, UserDefine=false, PduType=DBC
        CanConfigSet_Rx_CAN_Network_PMS_HVFunctionCtrl2: PduLength=8, UserDefine=false, PduType=DBC
        CanConfigSet_Rx_CAN_Network_PMS_PMSCtrl: PduLength=8, UserDefine=false, PduType=DBC
        CanConfigSet_Rx_CAN_Network_MCU_BodyControlInfo: PduLength=8, UserDefine=false, PduType=DBC
        CanConfigSet_Rx_CAN_Network_EMS_EngineRPM: PduLength=8, UserDefine=false, PduType=DBC
        CanConfigSet_Rx_CAN_Network_EMS_EngineDriverInfo: PduLength=8, UserDefine=false, PduType=DBC
        CanConfigSet_Rx_CAN_Network_MCU_PTInfoIndicate: PduLength=8, UserDefine=false, PduType=DBC
        CanConfigSet_Rx_CAN_Network_ACU_Status: PduLength=8, UserDefine=false, PduType=DBC
        CanConfigSet_Rx_CAN_Network_BBM_infor: PduLength=8, UserDefine=false, PduType=DBC
        CanConfigSet_Rx_CAN_Network_AC_ThermalReq: PduLength=8, UserDefine=false, PduType=DBC
        CanConfigSet_Rx_CAN_Network_AC_PTC_ACCM_Infor: PduLength=8, UserDefine=false, PduType=DBC
        CanConfigSet_Rx_CAN_Network_PMS_BatterySwap: PduLength=8, UserDefine=false, PduType=DBC
        CanConfigSet_Rx_CAN_Network_EMS_OBD_Info: PduLength=8, UserDefine=false, PduType=DBC
        CanConfigSet_Rx_CAN_Network_PMS_ACCtrl: PduLength=8, UserDefine=false, PduType=DBC
        CanConfigSet_Rx_CAN_Network_PMS_OBD_RequireInfo: PduLength=8, UserDefine=false, PduType=DBC
        CanConfigSet_Rx_CAN_Network_OBC_GeneralSts1: PduLength=8, UserDefine=false, PduType=DBC
        CanConfigSet_Rx_CAN_Network_PMS_NWM: PduLength=8, UserDefine=false, PduType=DBC
        CanConfigSet_Rx_CAN_Network_TMRU_NWM: PduLength=8, UserDefine=false, PduType=DBC
        CanConfigSet_Tx_CAN_Network_BMS_EnyInfo: PduLength=8, UserDefine=false, PduType=DBC
        CanConfigSet_Rx_CAN_Network_IC_VDHR: PduLength=8, UserDefine=false, PduType=DBC
        CanConfigSet_Rx_CAN_Network_ACCM_Status: PduLength=8, UserDefine=false, PduType=DBC
        CanConfigSet_Rx_CAN_Network_J1939Pdu_0x18ECFF27: PduLength=8, UserDefine=true, PduType=
        CanConfigSet_Rx_CAN_Network_J1939Pdu_0x18EBFF27: PduLength=8, UserDefine=true, PduType=
        CanIfTxPduTest: PduLength=8, UserDefine=true, PduType=
        PMS_EnyInfo: PduLength=8, UserDefine=true, PduType=
