AUTOSAR XML (schema 4-2-2)
package /EcucDefs
  ecuc definition collection AUTOSARParameterDefinition: module=[EcuC, Mcu]
  module config EcuC: implementation-config-variant=STD_CONFIG_VARIANTS_PRECOMPILE, module_version_def=1.0.0, module_autosar_version=Ar422
    EcuCGeneral: ConfigConsistencyHash=2718281828
    EcuCPartitionConfig_0 (EcuCPartitionConfig): index=0, EcuC_PartitionConfigId=42, EcuC_PartitionBootPriority=1, EcuC_PartitionType=OsPartition, EcuC_PartitionClockRef=ClockConfig_0
      EcuC_OsPartition: OsAppId=42
