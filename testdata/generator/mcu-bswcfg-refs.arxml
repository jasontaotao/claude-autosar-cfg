AUTOSAR XML (schema 4-2-2)
package /EcucDefs
  ecuc definition collection AUTOSARParameterDefinition: module=Mcu
  module config Mcu: implementation-config-variant=STD_CONFIG_VARIANTS_PRECOMPILE, module_version_def=1.0.0, module_autosar_version=Ar422
    ClockConfig_0 (McuClockSettingConfig): index=0, McuClockReferencePoint=8000000
