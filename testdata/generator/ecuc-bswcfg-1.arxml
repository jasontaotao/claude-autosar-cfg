AUTOSAR XML (schema 4-2-2)
package /EcucDefs
  ecuc definition collection AUTOSARParameterDefinition: module=EcuC
  module config EcuC: implementation-config-variant=STD_CONFIG_VARIANTS_PRECOMPILE, module_version_def=1.0.0, module_autosar_version=Ar422
    EcuCGeneral: ConfigConsistencyHash=3735928559
    3 x EcuCPartitionConfig:
      EcuCPartitionConfig_0: index=0, EcuC_PartitionConfigId=1, EcuC_PartitionBootPriority=10, EcuC_PartitionType=OsPartition
        EcuC_OsPartition: OsAppId=1
      EcuCPartitionConfig_1: index=1, EcuC_PartitionConfigId=2, EcuC_PartitionBootPriority=20, EcuC_PartitionType=OsPartition
        EcuC_OsPartition: OsAppId=2
      EcuCPartitionConfig_2: index=2, EcuC_PartitionConfigId=3, EcuC_PartitionBootPriority=30, EcuC_PartitionType=RomPartition
        EcuC_RomPartition: RomBlockId=100
