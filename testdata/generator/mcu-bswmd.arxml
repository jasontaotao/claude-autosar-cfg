AUTOSAR XML (schema 00046)
package /AUTOSAR
  module definition Mcu  # MCU driver (minimal stub for EcuC cross-module reference fixture).
    header Mcu/Mcu_Cfg.h
    std include Dem/Dem_Cfg.h
    container McuClockSettingConfig [0..*]: multiplicity set at pre-compile  # Clock setting configuration container.
      integer McuClockReferencePoint: 0..200000000, set at pre-compile  # Reference clock frequency (Hz).
