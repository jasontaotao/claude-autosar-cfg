AUTOSAR XML (schema 4-2-2)
package /EcucDefs
  ecuc definition collection AUTOSARParameterDefinition: module=EcuC
  module config EcuC: implementation-config-variant=STD_CONFIG_VARIANTS_PRECOMPILE, module_version_def=1.0.0, module_autosar_version=Ar422
    EcuCGeneral: ConfigConsistencyHash=305419896
    EcuCPartitionConfig_0 (EcuCPartitionConfig): index=0, EcuC_PartitionConfigId=1, EcuC_PartitionBootPriority=5, EcuC_PartitionType=OsPartition, EcuC_PartitionPostBuildHash=123456789
      EcuC_OsPartition: OsAppId=1
    EcuCPartitionConfig_1 (EcuCPartitionConfig): index=1, EcuC_PartitionConfigId=2, EcuC_PartitionBootPriority=15, EcuC_PartitionType=RomPartition, EcuC_PartitionPostBuildHash=987654321
      EcuC_RomPartition: RomBlockId=200
