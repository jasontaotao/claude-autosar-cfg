AUTOSAR XML (schema 00046)
package /AUTOSAR
  module definition EcuC: post-build-variant-support=true, variants pre-compile/post-build  # ECU Configuration (minimal subset for BSW generator v1.11 fixtures)
    header EcuC/EcuC_Cfg.h
    std include Os/Os_Cfg.h
    container EcuCGeneral  # General ECU configuration parameters.
      integer ConfigConsistencyHash: 0..4294967295, set at pre-compile in variant pre-compile / post-build in variant post-build  # Hash used to detect configuration consistency mismatches.
    container EcuCPartitionConfig [0..*]: multiplicity set at pre-compile  # Partition configuration (array, 0..10 instances).
      integer EcuC_PartitionConfigId: 0..65535, set at pre-compile  # Numeric partition identifier (uint16).
      integer EcuC_PartitionBootPriority: 0..255, set at pre-compile  # Boot priority of the partition (uint8).
      enumeration EcuC_PartitionType: {OsPartition, RomPartition}, set at pre-compile  # Partition type — OsPartition or RomPartition.
      integer EcuC_PartitionPostBuildHash: 0..4294967295, set at post-build  # PostBuild hash slot — used to trigger EcuC_PBcfg.c emission for the Mixed fixture.
      reference EcuC_PartitionClockRef [0..1]: multiplicity set at pre-compile, destination=McuClockSettingConfig  # Cross-module reference to Mcu/ClockConfig.
      choice container EcucPartitionChoice  # Partition backend choice (OsPartition vs RomPartition concrete container).
        container EcuC_OsPartition [0..1]  # Concrete container used when EcuC_PartitionType == OsPartition.
          integer OsAppId: 0..255, set at pre-compile  # OS application identifier.
        container EcuC_RomPartition [0..1]  # Concrete container used when EcuC_PartitionType == RomPartition.
          integer RomBlockId: 0..65535, set at pre-compile  # ROM block identifier.
